## package/singularity-session/Config.in
```kconfig
config BR2_PACKAGE_SINGULARITY_SESSION
	bool "singularity-session (full desktop)"
	depends on BR2_PACKAGE_LIBGTK4
	depends on BR2_PACKAGE_WEBKITGTK || BR2_PACKAGE_WEBKITGTK_PREBUILT
	depends on BR2_PACKAGE_GSTREAMER1
	select BR2_PACKAGE_LABWC
	select BR2_PACKAGE_SINGULARITY_SHELL
	select BR2_PACKAGE_SINGULARITY_DESKTOP_DATA
	select BR2_PACKAGE_SINGULARITY_THEMES
	select BR2_PACKAGE_SINGULARITY_WALLPAPERS
	select BR2_PACKAGE_SINGULARITY_WIDGETS
	select BR2_PACKAGE_SINGULARITY_PLUGINS
	select BR2_PACKAGE_SINGULARITY_POLKIT_AGENT
	select BR2_PACKAGE_XDG_DESKTOP_PORTAL_SINGULARITY
	select BR2_PACKAGE_SINGULARITY_SPLASH
	select BR2_PACKAGE_SINGULARITY_GREETER
	select BR2_PACKAGE_SINGULARITY_KEYRING
	select BR2_PACKAGE_SINGULARITY_FILES
	select BR2_PACKAGE_SINGULARITY_EDIT
	select BR2_PACKAGE_SINGULARITY_STORE
	select BR2_PACKAGE_SINGULARITY_MONITOR
	select BR2_PACKAGE_SINGULARITY_CALENDAR
	select BR2_PACKAGE_SINGULARITY_CALCULATOR
	select BR2_PACKAGE_SINGULARITY_LEAFS
	select BR2_PACKAGE_SINGULARITY_COLLECTION_RUNTIME
	help
	  The Singularity session: labwc session launcher and config plus
	  the Singularity desktop (shell, greeter, keyring and the core
	  apps). The other first-party apps install from the Singularity
	  collection.

	  https://github.com/singularityos-lab/singularity-session

config BR2_PACKAGE_SINGULARITY_COLLECTION_RUNTIME
	bool
	select BR2_PACKAGE_CAIRO
	select BR2_PACKAGE_FONTCONFIG
	select BR2_PACKAGE_FREETYPE
	select BR2_PACKAGE_GDK_PIXBUF
	select BR2_PACKAGE_GNUTLS
	select BR2_PACKAGE_GST1_PLUGINS_BASE
	select BR2_PACKAGE_GSTREAMER1
	select BR2_PACKAGE_GTKSOURCEVIEW
	select BR2_PACKAGE_HARFBUZZ
	select BR2_PACKAGE_JSON_GLIB
	select BR2_PACKAGE_LCMS2
	select BR2_PACKAGE_LIBFIDO2
	select BR2_PACKAGE_LIBGCRYPT
	select BR2_PACKAGE_LIBGEE
	select BR2_PACKAGE_LIBGPHOTO2
	select BR2_PACKAGE_LIBPEAS2
	select BR2_PACKAGE_LIBRSVG
	select BR2_PACKAGE_LIBSECRET
	select BR2_PACKAGE_LIBSOUP3
	select BR2_PACKAGE_LIBXML2
	select BR2_PACKAGE_MYTHES_DATA
	select BR2_PACKAGE_NETTLE
	select BR2_PACKAGE_PANGO
	select BR2_PACKAGE_POLKIT
	select BR2_PACKAGE_POPPLER
	select BR2_PACKAGE_SQLITE
	select BR2_PACKAGE_SQLITE_ENABLE_COLUMN_METADATA
	select BR2_PACKAGE_TIFF
	select BR2_PACKAGE_WEBP
	select BR2_PACKAGE_WEBP_MUX
	select BR2_PACKAGE_XZ
	select BR2_PACKAGE_ZBAR
	select BR2_PACKAGE_ZLIB
	select BR2_PACKAGE_ZSTD
	help
	  Libraries and data the apps of the Singularity collection
	  link against or read from the base system.
```

## package/singularity-sharing/Config.in
```kconfig
config BR2_PACKAGE_SINGULARITY_SHARING
	bool "singularity-sharing"
	depends on BR2_PACKAGE_LIBGTK4
	select BR2_PACKAGE_LIBSINGULARITY
	select BR2_PACKAGE_LIBGEE
	select BR2_PACKAGE_JSON_GLIB
	select BR2_PACKAGE_LIBSOUP3
	select BR2_PACKAGE_LIBSECRET
	help
	  Singularity Sharing: file, screen and remote sharing services.

	  https://github.com/singularityos-lab/singularity-sharing
```

## package/singularity-slides/Config.in
```kconfig
config BR2_PACKAGE_SINGULARITY_SLIDES
	bool "singularity-slides"
	depends on BR2_PACKAGE_LIBGTK4
	select BR2_PACKAGE_LIBSINGULARITY
	select BR2_PACKAGE_LIBGEE
	select BR2_PACKAGE_GSTREAMER1
	select BR2_PACKAGE_GST1_PLUGINS_BASE
	select BR2_PACKAGE_JSON_GLIB
	select BR2_PACKAGE_LIBSOUP3
	select BR2_PACKAGE_LIBXML2
	select BR2_PACKAGE_PANGO
	select BR2_PACKAGE_ZLIB
	help
	  Singularity Slides: create and present slideshows.

	  https://github.com/singularityos-lab/singularity-slides
```

## package/singularity-spreadsheet/Config.in
```kconfig
config BR2_PACKAGE_SINGULARITY_SPREADSHEET
	bool "singularity-spreadsheet"
	depends on BR2_PACKAGE_LIBGTK4
	select BR2_PACKAGE_LIBSINGULARITY
	select BR2_PACKAGE_LIBGEE
	select BR2_PACKAGE_JSON_GLIB
	select BR2_PACKAGE_LIBSOUP3
	select BR2_PACKAGE_LIBXML2
	select BR2_PACKAGE_PANGO
	select BR2_PACKAGE_SQLITE
	select BR2_PACKAGE_ZLIB
	help
	  Singularity Spreadsheet: work with numbers, formulas and charts.

	  https://github.com/singularityos-lab/singularity-spreadsheet
```

## package/singularity-tasks/Config.in
```kconfig
config BR2_PACKAGE_SINGULARITY_TASKS
	bool "singularity-tasks"
	depends on BR2_PACKAGE_LIBGTK4
	select BR2_PACKAGE_LIBSINGULARITY
	select BR2_PACKAGE_LIBGEE
	select BR2_PACKAGE_JSON_GLIB
	select BR2_PACKAGE_LIBPEAS2
	help
	  Singularity Tasks: plan what to do today and later.

	  https://github.com/singularityos-lab/singularity-tasks
```

## package/singularity-tour/Config.in
```kconfig
config BR2_PACKAGE_SINGULARITY_TOUR
	bool "singularity-tour"
	depends on BR2_PACKAGE_LIBGTK4
	select BR2_PACKAGE_LIBSINGULARITY
	select BR2_PACKAGE_LIBGEE
	select BR2_PACKAGE_PANGO
	help
	  Singularity Tour: a short look at how the desktop works.

	  https://github.com/singularityos-lab/singularity-tour
```

## package/singularity-translate/Config.in
```kconfig
config BR2_PACKAGE_SINGULARITY_TRANSLATE
	bool "singularity-translate"
	depends on BR2_PACKAGE_LIBGTK4
	select BR2_PACKAGE_LIBSINGULARITY
	select BR2_PACKAGE_LIBGEE
	select BR2_PACKAGE_JSON_GLIB
	select BR2_PACKAGE_LIBPEAS2
	select BR2_PACKAGE_LIBSECRET
	select BR2_PACKAGE_LIBSOUP3
	help
	  Singularity Translate: translate text between languages.

	  https://github.com/singularityos-lab/singularity-translate
```

## package/singularity-usage/Config.in
```kconfig
config BR2_PACKAGE_SINGULARITY_USAGE
	bool "singularity-usage"
	depends on BR2_PACKAGE_LIBGTK4
	select BR2_PACKAGE_LIBSINGULARITY
	select BR2_PACKAGE_LIBGEE
	help
	  Singularity Usage: see which folders and files take up space.

	  https://github.com/singularityos-lab/singularity-usage
```

## package/singularity-vector/Config.in
```kconfig
config BR2_PACKAGE_SINGULARITY_VECTOR
	bool "singularity-vector"
	depends on BR2_PACKAGE_LIBGTK4
	select BR2_PACKAGE_SINGULARITY_DRAW
	select BR2_PACKAGE_LIBSINGULARITY
	select BR2_PACKAGE_LIBGEE
	select BR2_PACKAGE_JSON_GLIB
	select BR2_PACKAGE_LCMS2
	select BR2_PACKAGE_LIBPEAS2
	select BR2_PACKAGE_TIFF
	select BR2_PACKAGE_LIBXML2
	select BR2_PACKAGE_PANGO
	select BR2_PACKAGE_ZLIB
	help
	  Singularity Vector: create illustrations, icons, and scalable graphics.

	  https://github.com/singularityos-lab/singularity-vector
```

## package/singularity-voice/Config.in
```kconfig
config BR2_PACKAGE_SINGULARITY_VOICE
	bool "singularity-voice"
	depends on BR2_PACKAGE_LIBGTK4
	select BR2_PACKAGE_LIBSINGULARITY
	select BR2_PACKAGE_LIBGEE
	select BR2_PACKAGE_GSTREAMER1
	select BR2_PACKAGE_GST1_PLUGINS_BASE
	select BR2_PACKAGE_JSON_GLIB
	help
	  Singularity Voice: record voice notes and meetings.

	  https://github.com/singularityos-lab/singularity-voice
```

## package/singularity-wave/Config.in
```kconfig
config BR2_PACKAGE_SINGULARITY_WAVE
	bool "singularity-wave"
	depends on BR2_PACKAGE_LIBGTK4
	select BR2_PACKAGE_LIBSINGULARITY
	select BR2_PACKAGE_CAIRO
	select BR2_PACKAGE_LIBGEE
	select BR2_PACKAGE_GSTREAMER1
	select BR2_PACKAGE_GST1_PLUGINS_BASE
	select BR2_PACKAGE_JSON_GLIB
	select BR2_PACKAGE_LIBXML2
	select BR2_PACKAGE_PANGO
	select BR2_PACKAGE_ZLIB
	help
	  Singularity Wave: record, edit, restore and mix audio.

	  https://github.com/singularityos-lab/singularity-wave
```

## package/singularity-weather/Config.in
```kconfig
config BR2_PACKAGE_SINGULARITY_WEATHER
	bool "singularity-weather"
	depends on BR2_PACKAGE_LIBGTK4
	select BR2_PACKAGE_LIBSINGULARITY
	select BR2_PACKAGE_LIBGEE
	select BR2_PACKAGE_JSON_GLIB
	select BR2_PACKAGE_LIBSOUP3
	help
	  Singularity Weather: forecasts, sunrise and sunset for any place.

	  https://github.com/singularityos-lab/singularity-weather
```

## package/sinit/Config.in
```kconfig
config BR2_PACKAGE_SINIT
	bool "sinit"
	depends on BR2_PACKAGE_HOST_GO_TARGET_ARCH_SUPPORTS
	depends on BR2_PACKAGE_HOST_GO_TARGET_CGO_LINKING_SUPPORTS
	help
	  sinit: the init system and service manager (PID 1) for Singularity
	  OS. A dependency-free, systemd-subset init written in Go. Installs
	  /usr/lib/sinit/sinit plus the client multicall symlinks (init,
	  atomctl, systemctl, reboot, poweroff, halt), so the de-systemd image
	  is self-contained and boots with init=/usr/lib/sinit/sinit -- no
	  manual injection.

	  https://github.com/singularityos-lab/sinit
```

## package/sinty-aegis/Config.in
```kconfig
config BR2_PACKAGE_SINTY_AEGIS
	bool "sinty-aegis"
	depends on BR2_PACKAGE_HOST_GO_TARGET_ARCH_SUPPORTS
	help
	  The public alert and emergency call service of SintyOS:
	  official alerts and earthquakes for the place the computer
	  is in, and the emergency numbers of the country, on
	  dev.sinty.Aegis1.

	  https://github.com/singularityos-lab/sinty-aegis
```

## package/sinty-agent-prebuilt/Config.in
```kconfig
config BR2_PACKAGE_SINTY_AGENT_PREBUILT
	bool "sinty-agent-prebuilt"
	depends on BR2_x86_64
	help
	  Sinty Agent: the system agent daemon, its bridge and command line tools.
```

## package/sinty-agent/Config.in
```kconfig
config BR2_PACKAGE_SINTY_AGENT
	bool "sinty-agent"
	depends on !BR2_PACKAGE_SINTY_AGENT_PREBUILT
	select BR2_PACKAGE_LIBGLIB2
	select BR2_PACKAGE_LIBSOUP3
	select BR2_PACKAGE_LIBSECRET
	select BR2_PACKAGE_WAYLAND
	select BR2_PACKAGE_ZLIB
	help
	  Sinty Agent built from source: the system agent daemon, its
	  bridge and command line tools.

	  https://github.com/singularityos-lab/sinty-agent
```

## package/sinty-board-firmware/Config.in
```kconfig
config BR2_PACKAGE_SINTY_BOARD_FIRMWARE
	bool "sinty-board-firmware"
	depends on BR2_aarch64
	help
	  UEFI firmware for boards that do not ship one, so they boot
	  the Sinty OS image like a PC: U-Boot with its EFI loader for
	  Jetson Nano, TX1 and TX2, EDK2 for Rock 5B and 5B+, and the
	  UEFI firmware for Raspberry Pi 4 and 5. The files land in
	  images/board-firmware, one folder per board.
```

## package/sinty-compute/Config.in
```kconfig
config BR2_PACKAGE_SINTY_COMPUTE
	bool "sinty-compute"
	depends on BR2_LINUX_KERNEL
	depends on BR2_x86_64
	help
	  Shared compute service: kernel module, daemon, library and command line tool.

	  https://github.com/singularityos-lab/sinty-compute
```

## package/sinty-cored/Config.in
```kconfig
config BR2_PACKAGE_SINTY_CORED
	bool "sinty-cored"
	depends on BR2_PACKAGE_HOST_GO_TARGET_ARCH_SUPPORTS
	select BR2_PACKAGE_SINTY_KEYD
	help
	  The Sinty Core service of SintyOS: shows the desktop on
	  paired screens over the network, Wi-Fi Direct or USB-C,
	  on dev.sinty.Core1. Also installs sinty-screen, the
	  framebuffer client for screens.

	  https://github.com/singularityos-lab/sinty-cored
```

## package/sinty-crypto/Config.in
```kconfig
config BR2_PACKAGE_SINTY_CRYPTO
	bool "sinty-crypto"
	select BR2_PACKAGE_LINUX_PAM
	select BR2_PACKAGE_TPM2_TOOLS
	help
	  Key-custody and PIN authentication for Singularity OS: the sintykey
	  CLI (provision / change-pin / verify-pin), the pam_sinty PAM module
	  (PIN -> TPM unseal -> fscrypt), and libsintykey. Built with Zig 0.16.

	  https://github.com/singularityos-lab/sinty-crypto
```

## package/sinty-desktopd/Config.in
```kconfig
config BR2_PACKAGE_SINTY_DESKTOPD
	bool "sinty-desktopd"
	depends on BR2_PACKAGE_HOST_GO_TARGET_ARCH_SUPPORTS
	help
	  Writes the login screen settings, installs fingerprint
	  reader drivers and reads the kernel log for the desktop
	  over D-Bus (dev.sinty.LoginScreen1,
	  dev.sinty.FingerprintDriver1, dev.sinty.Logs1), in place
	  of pkexec helpers.

	  https://github.com/singularityos-lab/sinty-desktopd
```

## package/sinty-devd/Config.in
```kconfig
config BR2_PACKAGE_SINTY_DEVD
	bool "sinty-devd"
	depends on BR2_PACKAGE_HOST_GO_TARGET_ARCH_SUPPORTS
	depends on BR2_PACKAGE_EUDEV
	help
	  Native device manager for SintyOS (de-systemd). Runs the udev
	  rules, manages device nodes and the udev database and speaks
	  the libudev protocol in place of udevd. The libudev library,
	  the rule helpers and the hardware database of eudev stay.
	  Installed as /usr/libexec/sinty-devd, with sinty-devadm wired
	  as /usr/bin/udevadm by the post-build script.

	  https://github.com/singularityos-lab/sinty-devd
```

## package/sinty-diskd/Config.in
```kconfig
config BR2_PACKAGE_SINTY_DISKD
	bool "sinty-diskd"
	depends on BR2_PACKAGE_HOST_GO_TARGET_ARCH_SUPPORTS
	help
	  The disk daemon of SintyOS: drives, block devices, partitions
	  and filesystems on org.freedesktop.UDisks2, with mounting,
	  formatting, partitioning, encryption and SMART. Replaces the
	  udisks daemon; libudisks2 stays for its clients.

	  https://github.com/singularityos-lab/sinty-diskd
```

## package/sinty-firewalld/Config.in
```kconfig
config BR2_PACKAGE_SINTY_FIREWALLD
	bool "sinty-firewalld"
	depends on BR2_PACKAGE_HOST_GO_TARGET_ARCH_SUPPORTS
	depends on BR2_PACKAGE_LIBSINGULARITY
	help
	  The firewall daemon of SintyOS: one nftables table written
	  over netlink, and dev.sinty.Firewall1 on the system bus so
	  Settings and apps can open ports. Needs no nft binary.

	  https://github.com/singularityos-lab/sinty-firewalld
```

## package/sinty-hostname/Config.in
```kconfig
config BR2_PACKAGE_SINTY_HOSTNAME
	bool "sinty-hostname"
	depends on BR2_PACKAGE_HOST_GO_TARGET_ARCH_SUPPORTS
	depends on BR2_PACKAGE_HOST_GO_TARGET_CGO_LINKING_SUPPORTS
	help
	  Native hostnamectl and hostname1 replacement for SintyOS
	  (de-systemd). Serves org.freedesktop.hostname1 so Settings
	  can show and change the computer name, and keeps the names
	  in /var/lib/singularity because /etc is read-only. Installed
	  as /usr/bin/sinty-hostname and wired as /usr/bin/hostnamectl
	  by the post-build script.

	  https://github.com/singularityos-lab/sinty-hostname
```
