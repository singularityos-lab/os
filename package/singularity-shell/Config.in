## package/singularity-shell/Config.in
```kconfig
config BR2_PACKAGE_SINGULARITY_SHELL
	bool "singularity-shell"
	depends on BR2_PACKAGE_LIBGTK4
	depends on BR2_PACKAGE_GOBJECT_INTROSPECTION
	depends on BR2_PACKAGE_WEBKITGTK_ARCH_SUPPORTS # gnome-online-accounts
	select BR2_PACKAGE_LIBSINGULARITY
	select BR2_PACKAGE_GTK4_LAYER_SHELL
	select BR2_PACKAGE_VTE_GTK4
	select BR2_PACKAGE_GTKSOURCEVIEW
	select BR2_PACKAGE_POPPLER
	select BR2_PACKAGE_NETWORK_MANAGER
	select BR2_PACKAGE_UPOWER
	select BR2_PACKAGE_PULSEAUDIO
	select BR2_PACKAGE_GNOME_ONLINE_ACCOUNTS
	select BR2_PACKAGE_POLKIT
	select BR2_PACKAGE_LINUX_PAM
	select BR2_PACKAGE_LIBSOUP3
	select BR2_PACKAGE_JSON_GLIB
	select BR2_PACKAGE_LIBPEAS2
	select BR2_PACKAGE_LIBDBUSMENU
	select BR2_PACKAGE_AT_SPI2_CORE
	select BR2_PACKAGE_TRACKER
	select BR2_PACKAGE_LIBGUDEV
	select BR2_PACKAGE_LIBGEE
	select BR2_PACKAGE_GSETTINGS_DESKTOP_SCHEMAS
	select BR2_PACKAGE_WAYLAND
	select BR2_PACKAGE_LIBXCB
	select BR2_PACKAGE_LIBPNG
	help
	  The Singularity desktop shell: panel, dock, overview, sidebar,
	  Control Center, spotlight, notifications, lock screen and the
	  global menu.

	  https://github.com/singularityos-lab/singularity-shell

comment "singularity-shell needs libgtk4 and gobject-introspection"
	depends on !BR2_PACKAGE_LIBGTK4 || !BR2_PACKAGE_GOBJECT_INTROSPECTION
```

## package/singularity-splash/Config.in
```kconfig
config BR2_PACKAGE_SINGULARITY_SPLASH
	bool "singularity-splash"
	select BR2_PACKAGE_SINGULARITY_LOGINUI
	help
	  The Singularity session splash shown between the greeter and the
	  shell while the desktop loads (Cairo/layer-shell, time-driven via
	  loginui_render_splash).

	  https://github.com/singularityos-lab/singularity-desktop
```

## package/singularity-store/Config.in
```kconfig
config BR2_PACKAGE_SINGULARITY_STORE
	bool "singularity-store"
	depends on BR2_PACKAGE_LIBGTK4
	select BR2_PACKAGE_LIBSINGULARITY
	select BR2_PACKAGE_LIBGEE
	select BR2_PACKAGE_LIBSOUP3
	select BR2_PACKAGE_JSON_GLIB
	help
	  Singularity Store: the application store.

	  https://github.com/singularityos-lab/singularity-store
```

## package/singularity-themes/Config.in
```kconfig
config BR2_PACKAGE_SINGULARITY_THEMES
	bool "singularity-themes"
	select BR2_PACKAGE_ADWAITA_ICON_THEME
	help
	  Singularity brand GTK themes (SingularityShell, Kids) and the
	  Singularity icon theme (inherits Adwaita).

	  https://github.com/singularityos-lab/singularity-themes
```

## package/singularity-videos/Config.in
```kconfig
config BR2_PACKAGE_SINGULARITY_VIDEOS
	bool "singularity-videos"
	depends on BR2_PACKAGE_LIBGTK4
	select BR2_PACKAGE_LIBSINGULARITY
	select BR2_PACKAGE_LIBGEE
	depends on BR2_PACKAGE_GSTREAMER1
	select BR2_PACKAGE_GST1_PLUGINS_BASE
	help
	  Singularity Videos: the video player.

	  https://github.com/singularityos-lab/singularity-videos
```

## package/singularity-wallpapers/Config.in
```kconfig
config BR2_PACKAGE_SINGULARITY_WALLPAPERS
	bool "singularity-wallpapers"
	help
	  Singularity desktop wallpapers, installed under
	  /usr/share/backgrounds/singularity.

	  https://github.com/singularityos-lab/singularity-wallpapers
```

## package/singularity-widgets/Config.in
```kconfig
config BR2_PACKAGE_SINGULARITY_WIDGETS
	bool "singularity-widgets"
	depends on BR2_PACKAGE_LIBGTK4
	select BR2_PACKAGE_LIBSINGULARITY
	select BR2_PACKAGE_LIBGEE
	help
	  Singularity desktop widgets (overview widget modules such as the
	  write notes and calculator widgets loaded by the shell).

	  https://github.com/singularityos-lab/singularity-widgets
```

## package/singularity-write/Config.in
```kconfig
config BR2_PACKAGE_SINGULARITY_WRITE
	bool "singularity-write"
	depends on BR2_PACKAGE_LIBGTK4
	depends on BR2_PACKAGE_WEBKITGTK
	select BR2_PACKAGE_LIBSINGULARITY
	select BR2_PACKAGE_LIBGEE
	select BR2_PACKAGE_GTKSOURCEVIEW
	select BR2_PACKAGE_POPPLER
	help
	  Singularity Write: the document writer.

	  https://github.com/singularityos-lab/singularity-write
```

## package/tracker-miners/Config.in
```kconfig
config BR2_PACKAGE_TRACKER_MINERS
	bool "tracker-miners"
	depends on BR2_PACKAGE_TRACKER
	select BR2_PACKAGE_UTIL_LINUX
	select BR2_PACKAGE_UTIL_LINUX_LIBBLKID
	help
	  Tracker filesystem miner (org.freedesktop.Tracker3.Miner.Files),
	  which indexes file names and metadata so the shell file search
	  works. Built minimal: the filesystem miner only, without the
	  media/document content extractors.

	  https://gitlab.gnome.org/GNOME/tracker-miners
```

## package/tracker/Config.in
```kconfig
config BR2_PACKAGE_TRACKER
	bool "tracker"
	depends on BR2_PACKAGE_GOBJECT_INTROSPECTION
	select BR2_PACKAGE_SQLITE
	select BR2_PACKAGE_JSON_GLIB
	select BR2_PACKAGE_ICU
	select BR2_PACKAGE_LIBGLIB2
	select BR2_PACKAGE_DBUS
	help
	  Tracker SPARQL 3.7 (provides tracker-sparql-3.0), the database
	  and query engine used by the Singularity shell for file search.

	  https://gnome.pages.gitlab.gnome.org/tracker/

comment "tracker needs gobject-introspection"
	depends on !BR2_PACKAGE_GOBJECT_INTROSPECTION
```

## package/vte-gtk4/Config.in
```kconfig
config BR2_PACKAGE_VTE_GTK4
	bool "vte (GTK4)"
	depends on BR2_PACKAGE_LIBGTK4
	select BR2_PACKAGE_PCRE2
	select BR2_PACKAGE_LZ4
	help
	  VTE terminal emulator widget built for GTK4 (provides
	  vte-2.91-gtk4). Used by the Leafs terminal.

	  https://gitlab.gnome.org/GNOME/vte

comment "vte (GTK4) needs libgtk4"
	depends on !BR2_PACKAGE_LIBGTK4
```

## package/webkitgtk-prebuilt/Config.in
```kconfig
config BR2_PACKAGE_WEBKITGTK_PREBUILT
	bool "webkitgtk (prebuilt)"
	depends on BR2_x86_64
	depends on !BR2_PACKAGE_WEBKITGTK
	depends on !BR2_STATIC_LIBS
	depends on BR2_INSTALL_LIBSTDCPP
	depends on BR2_TOOLCHAIN_HAS_THREADS_NPTL
	depends on BR2_USE_WCHAR
	select BR2_PACKAGE_LIBGTK4
	select BR2_PACKAGE_CAIRO
	select BR2_PACKAGE_CAIRO_PNG
	select BR2_PACKAGE_ENCHANT
	select BR2_PACKAGE_HARFBUZZ
	select BR2_PACKAGE_ICU
	select BR2_PACKAGE_JPEG
	select BR2_PACKAGE_LIBEPOXY
	select BR2_PACKAGE_LIBGCRYPT
	select BR2_PACKAGE_LIBSECRET
	select BR2_PACKAGE_LIBSOUP3
	select BR2_PACKAGE_LIBTASN1
	select BR2_PACKAGE_LIBXML2
	select BR2_PACKAGE_LIBXSLT
	select BR2_PACKAGE_SQLITE
	select BR2_PACKAGE_WEBP
	select BR2_PACKAGE_WEBP_DEMUX
	select BR2_PACKAGE_WEBP_MUX
	select BR2_PACKAGE_WOFF2
	select BR2_PACKAGE_LIBGBM
	select BR2_PACKAGE_LIBDRM
	select BR2_PACKAGE_SYSTEMD
	help
	  Temporary drop-in prebuilt WebKitGTK, for faster builds.

comment "webkitgtk-prebuilt needs a glibc toolchain w/ C++, NPTL, wchar (x86_64)"
	depends on BR2_x86_64
	depends on !BR2_INSTALL_LIBSTDCPP || !BR2_TOOLCHAIN_HAS_THREADS_NPTL \
		|| !BR2_USE_WCHAR || BR2_STATIC_LIBS
```

## package/wlroots020/Config.in
```kconfig
config BR2_PACKAGE_WLROOTS020
	bool "wlroots 0.20"
	depends on !BR2_STATIC_LIBS # wayland
	depends on BR2_TOOLCHAIN_HAS_THREADS # libdrm, wayland
	depends on BR2_PACKAGE_HAS_UDEV # libinput
	depends on BR2_PACKAGE_HAS_LIBEGL
	depends on BR2_PACKAGE_HAS_LIBGLES
	depends on BR2_PACKAGE_HAS_LIBGBM
	select BR2_PACKAGE_HWDATA
	select BR2_PACKAGE_HWDATA_PNP_IDS
	select BR2_PACKAGE_LIBDISPLAY_INFO
	select BR2_PACKAGE_LIBDRM
	select BR2_PACKAGE_LIBINPUT
	select BR2_PACKAGE_LIBLIFTOFF
	select BR2_PACKAGE_LIBXKBCOMMON
	select BR2_PACKAGE_PIXMAN
	select BR2_PACKAGE_SEATD
	select BR2_PACKAGE_WAYLAND
	select BR2_PACKAGE_WAYLAND_PROTOCOLS
	help
	  wlroots 0.20, the modular Wayland compositor library, built
	  with DRM multi-plane (libliftoff) support. Required by the
	  Singularity build of labwc.

	  https://gitlab.freedesktop.org/wlroots/wlroots

comment "wlroots 0.20 needs udev, EGL, OpenGL ES and GBM support"
	depends on !BR2_PACKAGE_HAS_LIBEGL || \
		!BR2_PACKAGE_HAS_LIBGLES || \
		!BR2_PACKAGE_HAS_LIBGBM || \
		!BR2_PACKAGE_HAS_UDEV
```

## package/xdg-desktop-portal-singularity/Config.in
```kconfig
config BR2_PACKAGE_XDG_DESKTOP_PORTAL_SINGULARITY
	bool "xdg-desktop-portal-singularity"
	depends on BR2_PACKAGE_LIBGTK4
	select BR2_PACKAGE_LIBSINGULARITY
	select BR2_PACKAGE_GTK4_LAYER_SHELL
	select BR2_PACKAGE_LIBGEE
	select BR2_PACKAGE_JSON_GLIB
	select BR2_PACKAGE_PIPEWIRE
	help
	  The Singularity xdg-desktop-portal backend (file chooser,
	  screenshot, screencast and related portal frontends).

	  https://github.com/singularityos-lab/xdg-desktop-portal-singularity
```

## package/xdg-desktop-portal/Config.in
```kconfig
config BR2_PACKAGE_XDG_DESKTOP_PORTAL
	bool "xdg-desktop-portal"
	depends on BR2_TOOLCHAIN_HAS_THREADS # glib2, pipewire
	depends on BR2_USE_WCHAR # glib2
	depends on BR2_USE_MMU # glib2
	depends on !BR2_STATIC_LIBS # libfuse3
	select BR2_PACKAGE_LIBGLIB2
	select BR2_PACKAGE_JSON_GLIB
	select BR2_PACKAGE_GDK_PIXBUF
	select BR2_PACKAGE_LIBFUSE3
	select BR2_PACKAGE_PIPEWIRE
	help
	  The freedesktop xdg-desktop-portal frontend
	  (org.freedesktop.portal.Desktop). It routes portal requests from
	  applications to the desktop backend implementation (here the
	  Singularity portal backend): file chooser, screenshot, screencast,
	  settings and more.

	  https://github.com/flatpak/xdg-desktop-portal
```

## package/xdg-user-dirs/Config.in
```kconfig
config BR2_PACKAGE_XDG_USER_DIRS
	bool "xdg-user-dirs"
	help
	  Tool to create and maintain the well-known user directories
	  (Desktop, Downloads, Documents, Pictures, Music, Videos).

	  https://www.freedesktop.org/wiki/Software/xdg-user-dirs/
```

## package/xsettingsd/Config.in
```kconfig
config BR2_PACKAGE_XSETTINGSD
	bool "xsettingsd"
	depends on BR2_PACKAGE_XORG7
	select BR2_PACKAGE_XLIB_LIBX11
	help
	  xsettingsd is a daemon that implements the XSETTINGS specification,
	  providing theme, font and cursor settings to X11 (XWayland)
	  applications. The Singularity shell launches it to keep XWayland
	  apps in sync with the desktop theme.

	  https://github.com/derat/xsettingsd
```
