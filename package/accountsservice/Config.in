## package/accountsservice/Config.in
```kconfig
config BR2_PACKAGE_ACCOUNTSSERVICE
	bool "accountsservice"
	depends on BR2_PACKAGE_HAS_UDEV
	depends on BR2_TOOLCHAIN_HAS_THREADS # glib2, polkit
	depends on BR2_USE_WCHAR # glib2, polkit
	depends on BR2_USE_MMU # glib2, polkit
	select BR2_PACKAGE_LIBGLIB2
	select BR2_PACKAGE_POLKIT
	help
	  D-Bus service (org.freedesktop.Accounts) for querying and
	  manipulating user account information, used by the shell account
	  page and for user avatars.

	  https://www.freedesktop.org/wiki/Software/AccountsService/
```

## package/gnome-online-accounts/Config.in
```kconfig
config BR2_PACKAGE_GNOME_ONLINE_ACCOUNTS
	bool "gnome-online-accounts"
	depends on BR2_PACKAGE_GOBJECT_INTROSPECTION
	depends on BR2_PACKAGE_WEBKITGTK_ARCH_SUPPORTS
	depends on BR2_PACKAGE_WEBKITGTK || BR2_PACKAGE_WEBKITGTK_PREBUILT
	select BR2_PACKAGE_LIBGLIB2
	select BR2_PACKAGE_LIBSOUP3
	select BR2_PACKAGE_JSON_GLIB
	select BR2_PACKAGE_LIBREST
	select BR2_PACKAGE_GCR
	select BR2_PACKAGE_LIBSECRET
	help
	  GNOME Online Accounts (provides goa-1.0 and goa-backend-1.0).
	  Used by the Singularity shell for online account integration
	  (calendar sync).

	  https://gitlab.gnome.org/GNOME/gnome-online-accounts

comment "gnome-online-accounts needs gobject-introspection"
	depends on !BR2_PACKAGE_GOBJECT_INTROSPECTION
```

## package/greetd/Config.in
```kconfig
config BR2_PACKAGE_GREETD
	bool "greetd"
	depends on BR2_PACKAGE_HOST_RUSTC_TARGET_ARCH_SUPPORTS
	depends on BR2_TOOLCHAIN_HAS_THREADS
	select BR2_PACKAGE_LINUX_PAM
	help
	  greetd is a minimal and flexible login manager daemon that
	  launches a greeter and starts a session on successful auth.
	  Singularity uses it to drive singularity-greeter.

	  https://git.sr.ht/~kennylevinsen/greetd

comment "greetd needs a toolchain w/ threads"
	depends on !BR2_TOOLCHAIN_HAS_THREADS
```

## package/gtk4-layer-shell/Config.in
```kconfig
config BR2_PACKAGE_GTK4_LAYER_SHELL
	bool "gtk4-layer-shell"
	depends on BR2_PACKAGE_LIBGTK4
	depends on BR2_PACKAGE_LIBGTK4_WAYLAND
	help
	  Layer shell protocol support for GTK4: lets a GTK4 window
	  become a panel, dock, or overlay on a wlroots-based Wayland
	  compositor.

	  https://github.com/wmww/gtk4-layer-shell

comment "gtk4-layer-shell needs libgtk4 with the Wayland backend"
	depends on !BR2_PACKAGE_LIBGTK4 || !BR2_PACKAGE_LIBGTK4_WAYLAND
```

## package/labwc/Config.in
```kconfig
config BR2_PACKAGE_LABWC
	bool "labwc"
	depends on !BR2_STATIC_LIBS
	depends on BR2_TOOLCHAIN_HAS_THREADS
	depends on BR2_PACKAGE_HAS_UDEV
	depends on BR2_PACKAGE_HAS_LIBEGL
	depends on BR2_PACKAGE_HAS_LIBGLES
	depends on BR2_PACKAGE_HAS_LIBGBM
	select BR2_PACKAGE_WLROOTS020
	select BR2_PACKAGE_LIBXML2
	select BR2_PACKAGE_CAIRO
	select BR2_PACKAGE_PANGO
	select BR2_PACKAGE_LIBGLIB2
	select BR2_PACKAGE_LIBRSVG
	help
	  labwc, the wlroots-based stacking Wayland compositor, in the
	  Singularity build that the shell drives.

	  https://github.com/singularityos-lab/labwc

comment "labwc needs udev, EGL, OpenGL ES and GBM support"
	depends on !BR2_PACKAGE_HAS_LIBEGL || \
		!BR2_PACKAGE_HAS_LIBGLES || \
		!BR2_PACKAGE_HAS_LIBGBM || \
		!BR2_PACKAGE_HAS_UDEV
```

## package/libdbusmenu/Config.in
```kconfig
config BR2_PACKAGE_LIBDBUSMENU
	bool "libdbusmenu"
	depends on BR2_PACKAGE_GOBJECT_INTROSPECTION
	select BR2_PACKAGE_LIBGLIB2
	help
	  Library to pass menu structures across D-Bus (provides
	  dbusmenu-glib-0.4). Used by the Singularity shell for the
	  DBusMenu global-menu fallback (Qt and legacy apps).

	  https://launchpad.net/libdbusmenu

comment "libdbusmenu needs gobject-introspection"
	depends on !BR2_PACKAGE_GOBJECT_INTROSPECTION
```

## package/libliftoff/Config.in
```kconfig
config BR2_PACKAGE_LIBLIFTOFF
	bool "libliftoff"
	select BR2_PACKAGE_LIBDRM
	help
	  Lightweight KMS plane library for offloading composition to
	  display hardware (DRM multi-plane). Used by wlroots.

	  https://gitlab.freedesktop.org/emersion/libliftoff
```

## package/libpeas2/Config.in
```kconfig
config BR2_PACKAGE_LIBPEAS2
	bool "libpeas2"
	depends on BR2_PACKAGE_GOBJECT_INTROSPECTION
	select BR2_PACKAGE_LIBGLIB2
	help
	  libpeas 2.x, the GObject-based plugin engine (provides
	  libpeas-2). Used by the Singularity shell to load plugins.

	  https://gitlab.gnome.org/GNOME/libpeas

comment "libpeas2 needs gobject-introspection"
	depends on !BR2_PACKAGE_GOBJECT_INTROSPECTION
```

## package/librest/Config.in
```kconfig
config BR2_PACKAGE_LIBREST
	bool "librest"
	depends on BR2_PACKAGE_GOBJECT_INTROSPECTION
	select BR2_PACKAGE_LIBGLIB2
	select BR2_PACKAGE_LIBSOUP3
	select BR2_PACKAGE_JSON_GLIB
	help
	  Helper library for RESTful web services (provides rest-1.0).
	  Required by gnome-online-accounts.

	  https://gitlab.gnome.org/GNOME/librest

comment "librest needs gobject-introspection"
	depends on !BR2_PACKAGE_GOBJECT_INTROSPECTION
```

## package/libsingularity/Config.in
```kconfig
config BR2_PACKAGE_LIBSINGULARITY
	bool "libsingularity"
	depends on BR2_PACKAGE_LIBGTK4
	depends on BR2_PACKAGE_GOBJECT_INTROSPECTION
	select BR2_PACKAGE_GTK4_LAYER_SHELL
	select BR2_PACKAGE_LIBPEAS2
	select BR2_PACKAGE_LIBGEE
	select BR2_PACKAGE_JSON_GLIB
	select BR2_PACKAGE_GTKSOURCEVIEW
	help
	  The Singularity application framework: GTK4 UI primitives, the
	  accent-aware style system, and the public contracts that the
	  shell and every first-party app build on.

	  https://github.com/singularityos-lab/libsingularity

comment "libsingularity needs libgtk4 and gobject-introspection"
	depends on !BR2_PACKAGE_LIBGTK4 || !BR2_PACKAGE_GOBJECT_INTROSPECTION
```

## package/singularity-boot-splash/Config.in
```kconfig
config BR2_PACKAGE_SINGULARITY_BOOT_SPLASH
	bool "singularity-boot-splash"
	select BR2_PACKAGE_SINGULARITY_LOGINUI
	select BR2_PACKAGE_LIBDRM
	help
	  A toolkit-less KMS boot splash (a Plymouth replacement) for
	  Singularity OS.

	  https://github.com/singularityos-lab/singularity-boot-splash
```

## package/singularity-calculator/Config.in
```kconfig
config BR2_PACKAGE_SINGULARITY_CALCULATOR
	bool "singularity-calculator"
	depends on BR2_PACKAGE_LIBGTK4
	select BR2_PACKAGE_LIBSINGULARITY
	select BR2_PACKAGE_LIBGEE
	help
	  Singularity Calculator: the calculator.

	  https://github.com/singularityos-lab/singularity-calculator
```

## package/singularity-calendar/Config.in
```kconfig
config BR2_PACKAGE_SINGULARITY_CALENDAR
	bool "singularity-calendar"
	depends on BR2_PACKAGE_LIBGTK4
	depends on BR2_PACKAGE_WEBKITGTK
	depends on BR2_PACKAGE_GOBJECT_INTROSPECTION
	select BR2_PACKAGE_LIBSINGULARITY
	select BR2_PACKAGE_LIBGEE
	select BR2_PACKAGE_GNOME_ONLINE_ACCOUNTS
	select BR2_PACKAGE_LIBSOUP3
	help
	  Singularity Calendar: the calendar.

	  https://github.com/singularityos-lab/singularity-calendar
```

## package/singularity-desktop-data/Config.in
```kconfig
config BR2_PACKAGE_SINGULARITY_DESKTOP_DATA
	bool "singularity-desktop-data"
	help
	  Top-level Singularity desktop data: the dev.sinty.desktop
	  GSettings schema (required by the shell), the xdg-desktop-portal
	  config, the polkit-agent and portal systemd user units, the
	  accountsservice interface and the brand emblem icon.

	  These live in the singularity-desktop meta repository, outside
	  any subprojct, so they are shipped as a standalone package. I
	  might improve it.

	  https://github.com/singularityos-lab/singularity-desktop
```

## package/singularity-edit/Config.in
```kconfig
config BR2_PACKAGE_SINGULARITY_EDIT
	bool "singularity-edit"
	depends on BR2_PACKAGE_LIBGTK4
	depends on BR2_PACKAGE_WEBKITGTK || BR2_PACKAGE_WEBKITGTK_PREBUILT
	select BR2_PACKAGE_LIBSINGULARITY
	select BR2_PACKAGE_LIBGEE
	select BR2_PACKAGE_GTKSOURCEVIEW
	help
	  Singularity Edit: the code editor.

	  https://github.com/singularityos-lab/singularity-edit
```

## package/singularity-files/Config.in
```kconfig
config BR2_PACKAGE_SINGULARITY_FILES
	bool "singularity-files"
	depends on BR2_PACKAGE_LIBGTK4
	select BR2_PACKAGE_LIBSINGULARITY
	select BR2_PACKAGE_LIBGEE
	select BR2_PACKAGE_LIBPEAS2
	select BR2_PACKAGE_JSON_GLIB
	help
	  Singularity Files: the file manager.

	  https://github.com/singularityos-lab/singularity-files
```

## package/singularity-git/Config.in
```kconfig
config BR2_PACKAGE_SINGULARITY_GIT
	bool "singularity-git"
	depends on BR2_PACKAGE_LIBGTK4
	select BR2_PACKAGE_LIBSINGULARITY
	select BR2_PACKAGE_LIBGEE
	select BR2_PACKAGE_GTKSOURCEVIEW
	help
	  Singularity Git: the git client.

	  https://github.com/singularityos-lab/singularity-git
```

## package/singularity-installer/Config.in
```kconfig
config BR2_PACKAGE_SINGULARITY_INSTALLER
	bool "singularity-installer"
	depends on BR2_PACKAGE_LIBGTK4
	select BR2_PACKAGE_LIBSINGULARITY
	select BR2_PACKAGE_LIBGEE
	select BR2_PACKAGE_JSON_GLIB
	select BR2_PACKAGE_LIBXML2
	help
	  Sinty OS installer and first-boot setup (OOBE).

	  https://github.com/singularityos-lab/singularity-installer
```

## package/singularity-keyring/Config.in
```kconfig
config BR2_PACKAGE_SINGULARITY_KEYRING
	bool "singularity-keyring"
	depends on BR2_PACKAGE_LIBGTK4
	select BR2_PACKAGE_JSON_GLIB
	select BR2_PACKAGE_LIBGCRYPT
	select BR2_PACKAGE_LIBSODIUM
	help
	  Singularity Keyring: the Secret Service daemon (org.freedesktop.secrets)
	  backing credential storage for the desktop.

	  https://github.com/singularityos-lab/singularity-keyring
```

## package/singularity-leafs/Config.in
```kconfig
config BR2_PACKAGE_SINGULARITY_LEAFS
	bool "singularity-leafs"
	depends on BR2_PACKAGE_LIBGTK4
	select BR2_PACKAGE_LIBSINGULARITY
	select BR2_PACKAGE_LIBGEE
	select BR2_PACKAGE_VTE_GTK4
	select BR2_PACKAGE_JSON_GLIB
	help
	  Singularity Leafs: the terminal.

	  https://github.com/singularityos-lab/singularity-leafs
```

## package/singularity-loginui/Config.in
```kconfig
config BR2_PACKAGE_SINGULARITY_LOGINUI
	bool "singularity-loginui"
	select BR2_PACKAGE_CAIRO
	select BR2_PACKAGE_PANGO
	select BR2_PACKAGE_GDK_PIXBUF
	select BR2_PACKAGE_WAYLAND
	help
	  Shared toolkit-less Cairo render library for the Singularity login
	  surfaces: the greeter, the lock screen, the session splash and the
	  boot splash.

	  https://github.com/singularityos-lab/singularity-loginui
```

## package/singularity-monitor/Config.in
```kconfig
config BR2_PACKAGE_SINGULARITY_MONITOR
	bool "singularity-monitor"
	depends on BR2_PACKAGE_LIBGTK4
	select BR2_PACKAGE_LIBSINGULARITY
	select BR2_PACKAGE_LIBGEE
	help
	  Singularity Monitor: the system monitor.

	  https://github.com/singularityos-lab/singularity-monitor
```

## package/singularity-music/Config.in
```kconfig
config BR2_PACKAGE_SINGULARITY_MUSIC
	bool "singularity-music"
	depends on BR2_PACKAGE_LIBGTK4
	select BR2_PACKAGE_LIBSINGULARITY
	select BR2_PACKAGE_LIBGEE
	depends on BR2_PACKAGE_GSTREAMER1
	select BR2_PACKAGE_GST1_PLUGINS_BASE
	select BR2_PACKAGE_LIBSOUP3
	help
	  Singularity Music: the music player.

	  https://github.com/singularityos-lab/singularity-music
```

## package/singularity-plugins/Config.in
```kconfig
config BR2_PACKAGE_SINGULARITY_PLUGINS
	bool "singularity-plugins"
	depends on BR2_PACKAGE_LIBGTK4
	select BR2_PACKAGE_LIBSINGULARITY
	select BR2_PACKAGE_LIBPEAS2
	select BR2_PACKAGE_LIBGEE
	help
	  Singularity shell plugins (caffeine, clipboard history, color
	  picker, pomodoro, weather and the various dock and panel widgets)
	  loaded by the shell through libpeas.

	  https://github.com/singularityos-lab/singularity-plugins
```

## package/singularity-polkit-agent/Config.in
```kconfig
config BR2_PACKAGE_SINGULARITY_POLKIT_AGENT
	bool "singularity-polkit-agent"
	depends on BR2_PACKAGE_LIBGTK4
	select BR2_PACKAGE_LIBSINGULARITY
	select BR2_PACKAGE_POLKIT
	help
	  The Singularity polkit authentication agent (started by the
	  desktop session to handle privilege escalation prompts).

	  https://github.com/singularityos-lab/singularity-polkit-agent
```
