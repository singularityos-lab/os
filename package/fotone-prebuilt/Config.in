## package/fotone-prebuilt/Config.in
```kconfig
config BR2_PACKAGE_FOTONE_PREBUILT
	bool "fotone (prebuilt)"
	depends on BR2_x86_64 || BR2_aarch64
	depends on BR2_PACKAGE_WEBKITGTK_PREBUILT || BR2_PACKAGE_WEBKITGTK
	depends on !BR2_PACKAGE_FOTONE
	select BR2_PACKAGE_DAV1D
	select BR2_PACKAGE_LIBJXL
	select BR2_PACKAGE_HOST_PATCHELF
	select BR2_PACKAGE_AT_SPI2_CORE if BR2_PACKAGE_WEBKITGTK
	select BR2_PACKAGE_ENCHANT if BR2_PACKAGE_WEBKITGTK
	select BR2_PACKAGE_EXPAT if BR2_PACKAGE_WEBKITGTK
	select BR2_PACKAGE_FONTCONFIG if BR2_PACKAGE_WEBKITGTK
	select BR2_PACKAGE_FREETYPE if BR2_PACKAGE_WEBKITGTK
	select BR2_PACKAGE_GNUTLS if BR2_PACKAGE_WEBKITGTK
	select BR2_PACKAGE_GSTREAMER1 if BR2_PACKAGE_WEBKITGTK
	select BR2_PACKAGE_GST1_PLUGINS_BASE if BR2_PACKAGE_WEBKITGTK
	select BR2_PACKAGE_GST1_PLUGINS_BASE_LIB_OPENGL if BR2_PACKAGE_HAS_LIBEGL && BR2_PACKAGE_WEBKITGTK
	select BR2_PACKAGE_GST1_PLUGINS_BAD if BR2_PACKAGE_WEBKITGTK
	select BR2_PACKAGE_HARFBUZZ if BR2_PACKAGE_WEBKITGTK
	select BR2_PACKAGE_ICU if BR2_PACKAGE_WEBKITGTK
	select BR2_PACKAGE_JPEG if BR2_PACKAGE_WEBKITGTK
	select BR2_PACKAGE_LCMS2 if BR2_PACKAGE_WEBKITGTK
	select BR2_PACKAGE_LIBAVIF if BR2_PACKAGE_WEBKITGTK
	select BR2_PACKAGE_LIBDRM if BR2_PACKAGE_WEBKITGTK
	select BR2_PACKAGE_LIBEPOXY if BR2_PACKAGE_WEBKITGTK
	select BR2_PACKAGE_LIBGCRYPT if BR2_PACKAGE_WEBKITGTK
	select BR2_PACKAGE_LIBINPUT if BR2_PACKAGE_WEBKITGTK
	select BR2_PACKAGE_LIBPNG if BR2_PACKAGE_WEBKITGTK
	select BR2_PACKAGE_LIBSECRET if BR2_PACKAGE_WEBKITGTK
	select BR2_PACKAGE_LIBSOUP3 if BR2_PACKAGE_WEBKITGTK
	select BR2_PACKAGE_LIBTASN1 if BR2_PACKAGE_WEBKITGTK
	select BR2_PACKAGE_LIBXKBCOMMON if BR2_PACKAGE_WEBKITGTK
	select BR2_PACKAGE_LIBXML2 if BR2_PACKAGE_WEBKITGTK
	select BR2_PACKAGE_LIBXSLT if BR2_PACKAGE_WEBKITGTK
	select BR2_PACKAGE_SQLITE if BR2_PACKAGE_WEBKITGTK
	select BR2_PACKAGE_WAYLAND if BR2_PACKAGE_WEBKITGTK
	select BR2_PACKAGE_WAYLAND_PROTOCOLS if BR2_PACKAGE_WEBKITGTK
	select BR2_PACKAGE_WEBP if BR2_PACKAGE_WEBKITGTK
	select BR2_PACKAGE_WEBP_DEMUX if BR2_PACKAGE_WEBKITGTK
	select BR2_PACKAGE_WEBP_MUX if BR2_PACKAGE_WEBKITGTK
	select BR2_PACKAGE_WOFF2 if BR2_PACKAGE_WEBKITGTK
	help
	  Fotone web engine: WPE WebKit with the Sinty patches and the
	  WebKitGTK compatible libraries that apps load in its place.

	  https://github.com/singularityos-lab/fotone
```

## package/gamemode/Config.in
```kconfig
config BR2_PACKAGE_GAMEMODE
	bool "gamemode"
	depends on BR2_USE_MMU
	select BR2_PACKAGE_BASU
	select BR2_PACKAGE_DBUS
	select BR2_PACKAGE_INIH
	help
	  Feral Interactive GameMode: a daemon games ask to apply
	  performance tweaks while they run.

	  https://github.com/FeralInteractive/gamemode
```

## package/iride/Config.in
```kconfig
config BR2_PACKAGE_IRIDE
	bool "iride"
	depends on BR2_x86_64 || BR2_aarch64
	select BR2_PACKAGE_GDK_PIXBUF
	select BR2_PACKAGE_LIBGLIB2
	help
	  Reader of the Iride icon format, used by the toolkit to show
	  compiled icons.

	  https://github.com/singularityos-lab/iride
```

## package/mangohud/Config.in
```kconfig
config BR2_PACKAGE_MANGOHUD
	bool "mangohud"
	depends on BR2_INSTALL_LIBSTDCPP
	select BR2_PACKAGE_DBUS
	select BR2_PACKAGE_XLIB_LIBX11
	select BR2_PACKAGE_LIBXKBCOMMON
	select BR2_PACKAGE_WAYLAND
	select BR2_PACKAGE_VULKAN_LOADER
	help
	  Vulkan and OpenGL overlay that shows frame rate, frame time
	  and processor and graphics load in games.

	  https://github.com/flightlessmango/MangoHud
```

## package/omamobile-audio/Config.in
```kconfig
config BR2_PACKAGE_OMAMOBILE_AUDIO
	bool "omamobile-audio"
	depends on BR2_PACKAGE_BASH
	depends on BR2_PACKAGE_PYTHON3
	select BR2_PACKAGE_ALSA_UTILS
	select BR2_PACKAGE_ALSA_UTILS_AMIXER
	select BR2_PACKAGE_ALSA_UTILS_ALSAUCM
	select BR2_PACKAGE_E2FSPROGS
	select BR2_PACKAGE_E2FSPROGS_DEBUGFS
	help
	  Speaker protection, UCM2 profiles and WirePlumber rules for the
	  Google Tensor AoC sound card, from Omarchy Mobile. The protection
	  service loads the Cirrus amplifier firmware with the factory
	  calibration before it ever unmutes the speakers, and its watchdog
	  mutes them again if the protection stops.

	  https://github.com/derekross/omarchy-mobile
```

## package/omamobile-camera-data/Config.in
```kconfig
config BR2_PACKAGE_OMAMOBILE_CAMERA_DATA
	bool "omamobile-camera-data"
	depends on BR2_PACKAGE_PYTHON3
	select BR2_PACKAGE_UNICORN
	select BR2_PACKAGE_PYTHON_PYELFTOOLS
	select BR2_PACKAGE_UNZIP
	select BR2_PACKAGE_E2FSPROGS
	select BR2_PACKAGE_E2FSPROGS_DEBUGFS
	help
	  The Omarchy Mobile tool that builds a Pixel's camera sensor and
	  receiver data files from the camera HAL in the phone's own vendor
	  partition. sinty-vendor-firmware runs it on the device; nothing
	  derived from the vendor software is shipped in the image.

	  https://github.com/derekross/omarchy-mobile
```

## package/python-pyelftools/Config.in
```kconfig
config BR2_PACKAGE_PYTHON_PYELFTOOLS
	bool "python-pyelftools"
	help
	  Library for analyzing ELF files and DWARF debugging
	  information.

	  https://github.com/eliben/pyelftools
```

## package/qrtr/Config.in
```kconfig
config BR2_PACKAGE_QRTR
	bool "qrtr"
	depends on BR2_TOOLCHAIN_HAS_THREADS
	help
	  Userspace library and tools for the Qualcomm IPC Router
	  protocol, used to talk to the modem and DSP subsystems.

	  https://github.com/linux-msm/qrtr

comment "qrtr needs a toolchain w/ threads"
	depends on !BR2_TOOLCHAIN_HAS_THREADS
```

## package/rmtfs/Config.in
```kconfig
config BR2_PACKAGE_RMTFS
	bool "rmtfs"
	depends on BR2_PACKAGE_HAS_UDEV
	depends on BR2_TOOLCHAIN_HAS_THREADS
	select BR2_PACKAGE_QRTR
	help
	  Qualcomm remote filesystem service. It serves the modem its
	  storage partitions and boots the modem remote processor,
	  which on boards such as the QCM2290 also runs the wifi
	  firmware.

	  https://github.com/linux-msm/rmtfs

comment "rmtfs needs udev and a toolchain w/ threads"
	depends on !BR2_PACKAGE_HAS_UDEV || !BR2_TOOLCHAIN_HAS_THREADS
```

## package/singularity-phone/Config.in
```kconfig
config BR2_PACKAGE_SINGULARITY_PHONE
	bool "singularity-phone"
	depends on BR2_PACKAGE_LIBGTK4
	select BR2_PACKAGE_LIBSINGULARITY
	select BR2_PACKAGE_LIBGEE
	select BR2_PACKAGE_JSON_GLIB
	help
	  Singularity Phone: voice calls through ModemManager.

	  https://github.com/singularityos-lab/singularity-phone
```

## package/sinty-device-tools/Config.in
```kconfig
config BR2_PACKAGE_SINTY_DEVICE_TOOLS
	bool "sinty-device-tools"
	depends on BR2_PACKAGE_HOST_GO_TARGET_ARCH_SUPPORTS
	help
	  The on-device tools of the Sinty device catalog: the firmware a
	  profile takes from the Android vendor partition still on the
	  device, and the Atom Loops kernel hook that keeps a phone's boot
	  partitions on the kernel of the root it runs.

	  https://github.com/singularityos-lab/sinty-devices
```

## package/sinty-domaind/Config.in
```kconfig
config BR2_PACKAGE_SINTY_DOMAIND
	bool "sinty-domaind"
	depends on BR2_PACKAGE_HOST_GO_TARGET_ARCH_SUPPORTS
	help
	  Organisation accounts for SintyOS: joins a Kerberos domain,
	  signs domain users in through pam_sinty with an encrypted
	  local home, and recognises the organisation's network.

	  https://github.com/singularityos-lab/sinty-domaind
```

## package/sinty-identity/Config.in
```kconfig
config BR2_PACKAGE_SINTY_IDENTITY
	bool "sinty-identity"
	depends on BR2_PACKAGE_HOST_GO_TARGET_ARCH_SUPPORTS
	select BR2_PACKAGE_SINTY_KEYD
	help
	  Sign-in confirmations for SintyOS: enrolls the device as one
	  of the person's Sinty sign-in devices, with a key kept in the
	  TPM, and lists the sign-ins waiting for their approval.

	  https://github.com/singularityos-lab/sinty-identity
```

## package/sinty-it-app/Config.in
```kconfig
config BR2_PACKAGE_SINTY_IT_APP
	bool "sinty-it-app"
	depends on BR2_PACKAGE_LIBGTK4
	select BR2_PACKAGE_LIBSINGULARITY
	select BR2_PACKAGE_LIBGEE
	select BR2_PACKAGE_JSON_GLIB
	select BR2_PACKAGE_LIBSOUP3
	help
	  Sinty IT: manage the organisation's devices from the desktop
	  with the organisation account added in Settings.

	  https://github.com/singularityos-lab/sinty-it
```

## package/sinty-it/Config.in
```kconfig
config BR2_PACKAGE_SINTY_IT
	bool "sinty-it"
	depends on BR2_PACKAGE_HOST_GO_TARGET_ARCH_SUPPORTS
	help
	  Device management agent for SintyOS: enrolls the device with
	  the organisation's Sinty IT server, reports its protection
	  state and runs the signed commands it receives.

	  https://github.com/singularityos-lab/sinty-it
```

## package/sinty-matrix/Config.in
```kconfig
config BR2_PACKAGE_SINTY_MATRIX
	bool "sinty-matrix"
	depends on BR2_x86_64 || BR2_aarch64
	help
	  LED matrix service and matrix controller firmware.

	  https://github.com/singularityos-lab/sinty-matrix
```

## package/sinty-modemd/Config.in
```kconfig
config BR2_PACKAGE_SINTY_MODEMD
	bool "sinty-modemd"
	depends on BR2_PACKAGE_HOST_GO_TARGET_ARCH_SUPPORTS
	select BR2_PACKAGE_MOBILE_BROADBAND_PROVIDER_INFO
	help
	  sinty-modemd: the Sinty OS cellular modem service. Boots the
	  phone's baseband and serves the ModemManager D-Bus API for
	  calls, SMS and mobile data. Installs /usr/bin/sinty-modemd.

	  https://github.com/singularityos-lab/sinty-modem
```

## package/sinty-recoverd/Config.in
```kconfig
config BR2_PACKAGE_SINTY_RECOVERD
	bool "sinty-recoverd"
	depends on BR2_TOOLCHAIN_USES_GLIBC
	select BR2_PACKAGE_LIBXCRYPT
	help
	  Root daemon: the recovery escape hatch for the pre-login greeter.
	  Performs `sintykey recover` on behalf of the unprivileged greeter,
	  gated by the recovery code, over a unix socket.
```

## package/sinty-vendor-firmware/Config.in
```kconfig
config BR2_PACKAGE_SINTY_VENDOR_FIRMWARE
	bool "sinty-vendor-firmware"
	depends on BR2_PACKAGE_HOST_GO_TARGET_ARCH_SUPPORTS
	help
	  Installs the firmware a device profile takes from the Android
	  vendor partition still on the device, such as the Wi-Fi, audio
	  and amplifier firmware of a Pixel, read through a read-only
	  mapping of its super partition.

	  https://github.com/singularityos-lab/sinty-devices
```

## package/sinty-words/Config.in
```kconfig
config BR2_PACKAGE_SINTY_WORDS
	bool "sinty-words"
	help
	  Word lists with frequencies for the on-screen keyboard:
	  completion, correction and swipe typing.

	  https://github.com/singularityos-lab/sinty-words
```

## package/tqftpserv/Config.in
```kconfig
config BR2_PACKAGE_TQFTPSERV
	bool "tqftpserv"
	depends on BR2_TOOLCHAIN_HAS_THREADS
	select BR2_PACKAGE_QRTR
	help
	  TFTP server over the Qualcomm IPC Router. The modem fetches
	  its runtime firmware files, such as the wifi firmware, from
	  it.

	  https://github.com/linux-msm/tqftpserv

comment "tqftpserv needs a toolchain w/ threads"
	depends on !BR2_TOOLCHAIN_HAS_THREADS
```

## package/unicorn/Config.in
```kconfig
config BR2_PACKAGE_UNICORN
	bool "unicorn"
	depends on BR2_PACKAGE_PYTHON3
	help
	  Unicorn CPU emulator, built for AArch64 guests only, with its
	  Python bindings. Used to derive device data from the owner's
	  own vendor software at first boot.

	  https://www.unicorn-engine.org
```
