## package/singularity-fonts/Config.in
```kconfig
config BR2_PACKAGE_SINGULARITY_FONTS
	bool "singularity-fonts"
	depends on BR2_PACKAGE_LIBGTK4
	select BR2_PACKAGE_LIBSINGULARITY
	select BR2_PACKAGE_LIBGEE
	select BR2_PACKAGE_LIBPEAS2
	select BR2_PACKAGE_PANGO
	help
	  Singularity Fonts: browse, preview and install fonts.

	  https://github.com/singularityos-lab/singularity-fonts
```

## package/singularity-formula/Config.in
```kconfig
config BR2_PACKAGE_SINGULARITY_FORMULA
	bool "singularity-formula"
	depends on BR2_PACKAGE_LIBGTK4
	select BR2_PACKAGE_LIBSINGULARITY
	select BR2_PACKAGE_CAIRO
	select BR2_PACKAGE_FONTCONFIG
	select BR2_PACKAGE_FREETYPE
	select BR2_PACKAGE_LIBGEE
	select BR2_PACKAGE_HARFBUZZ
	select BR2_PACKAGE_LIBXML2
	select BR2_PACKAGE_PANGO
	select BR2_PACKAGE_ZLIB
	help
	  Singularity Formula: write equations for documents, slides and the web.

	  https://github.com/singularityos-lab/singularity-formula
```

## package/singularity-gestures/Config.in
```kconfig
config BR2_PACKAGE_SINGULARITY_GESTURES
	bool "singularity-gestures"
	depends on BR2_PACKAGE_LIBGTK4
	depends on BR2_PACKAGE_MESA3D_OPENGL_GLX
	select BR2_PACKAGE_SDL2
	select BR2_PACKAGE_LIBGLU
	depends on BR2_PACKAGE_XORG7
	select BR2_PACKAGE_XLIB_LIBX11
	select BR2_PACKAGE_GTK4_LAYER_SHELL
	select BR2_PACKAGE_WAYLAND
	select BR2_PACKAGE_LIBXKBCOMMON
	select BR2_PACKAGE_GSTREAMER1
	select BR2_PACKAGE_GST1_PLUGINS_BASE
	select BR2_PACKAGE_CAIRO
	select BR2_PACKAGE_PANGO
	help
	  Singularity Gestures: hand and gaze tracking for the desktop.
	  Camera frames are processed locally and kept in memory.

	  https://github.com/singularityos-lab/singularity-gestures
```

## package/singularity-greeter/Config.in
```kconfig
config BR2_PACKAGE_SINGULARITY_GREETER
	bool "singularity-greeter"
	depends on BR2_PACKAGE_LIBGTK4
	select BR2_PACKAGE_LIBSINGULARITY
	select BR2_PACKAGE_GTK4_LAYER_SHELL
	select BR2_PACKAGE_LIBGEE
	select BR2_PACKAGE_JSON_GLIB
	select BR2_PACKAGE_SINTY_LOGIND
	help
	  Singularity Greeter: the greetd-based login screen for the
	  Singularity desktop.

	  https://github.com/singularityos-lab/singularity-greeter
```

## package/singularity-help/Config.in
```kconfig
config BR2_PACKAGE_SINGULARITY_HELP
	bool "singularity-help"
	depends on BR2_PACKAGE_LIBGTK4
	select BR2_PACKAGE_LIBSINGULARITY
	select BR2_PACKAGE_LIBGEE
	select BR2_PACKAGE_LIBXML2
	select BR2_PACKAGE_PANGO
	help
	  Singularity Help: guides for the desktop, your apps and your system.

	  https://github.com/singularityos-lab/singularity-help
```

## package/singularity-keyframe/Config.in
```kconfig
config BR2_PACKAGE_SINGULARITY_KEYFRAME
	bool "singularity-keyframe"
	depends on BR2_PACKAGE_LIBGTK4
	select BR2_PACKAGE_SINGULARITY_DRAW
	select BR2_PACKAGE_LIBSINGULARITY
	select BR2_PACKAGE_CAIRO
	select BR2_PACKAGE_GDK_PIXBUF
	select BR2_PACKAGE_LIBGEE
	select BR2_PACKAGE_GSTREAMER1
	select BR2_PACKAGE_GST1_PLUGINS_BASE
	select BR2_PACKAGE_JSON_GLIB
	select BR2_PACKAGE_LIBPEAS2
	select BR2_PACKAGE_PANGO
	select BR2_PACKAGE_ZLIB
	help
	  Singularity Keyframe: animate titles, graphics and effects, and composite video.

	  https://github.com/singularityos-lab/singularity-keyframe
```

## package/singularity-lettere/Config.in
```kconfig
config BR2_PACKAGE_SINGULARITY_LETTERE
	bool "singularity-lettere"
	depends on BR2_PACKAGE_LIBGTK4
	depends on BR2_PACKAGE_WEBKITGTK || BR2_PACKAGE_WEBKITGTK_PREBUILT
	select BR2_PACKAGE_LIBSINGULARITY
	select BR2_PACKAGE_LIBGEE
	select BR2_PACKAGE_GSTREAMER1
	select BR2_PACKAGE_JSON_GLIB
	select BR2_PACKAGE_LIBSECRET
	select BR2_PACKAGE_LIBSOUP3
	select BR2_PACKAGE_POPPLER
	select BR2_PACKAGE_SQLITE
	help
	  Singularity Lettere: read and write email.

	  https://github.com/singularityos-lab/singularity-lettere
```

## package/singularity-logs/Config.in
```kconfig
config BR2_PACKAGE_SINGULARITY_LOGS
	bool "singularity-logs"
	depends on BR2_PACKAGE_LIBGTK4
	select BR2_PACKAGE_LIBSINGULARITY
	select BR2_PACKAGE_LIBGEE
	select BR2_PACKAGE_JSON_GLIB
	help
	  Singularity Logs: read the messages the system and apps write.

	  https://github.com/singularityos-lab/singularity-logs
```

## package/singularity-machines/Config.in
```kconfig
config BR2_PACKAGE_SINGULARITY_MACHINES
	bool "singularity-machines"
	depends on BR2_PACKAGE_LIBGTK4
	select BR2_PACKAGE_LIBSINGULARITY
	select BR2_PACKAGE_LIBGEE
	select BR2_PACKAGE_JSON_GLIB
	help
	  Singularity Machines: run other operating systems in virtual machines.

	  https://github.com/singularityos-lab/singularity-machines
```

## package/singularity-maps/Config.in
```kconfig
config BR2_PACKAGE_SINGULARITY_MAPS
	bool "singularity-maps"
	depends on BR2_PACKAGE_LIBGTK4
	select BR2_PACKAGE_LIBSINGULARITY
	select BR2_PACKAGE_LIBGEE
	select BR2_PACKAGE_JSON_GLIB
	select BR2_PACKAGE_LIBSOUP3
	help
	  Singularity Maps: find places and plan routes.

	  https://github.com/singularityos-lab/singularity-maps
```

## package/singularity-media-plugins/Config.in
```kconfig
config BR2_PACKAGE_SINGULARITY_MEDIA_PLUGINS
	bool "singularity-media-plugins"
	depends on BR2_PACKAGE_LIBGTK4
	depends on BR2_PACKAGE_WEBKITGTK || BR2_PACKAGE_WEBKITGTK_PREBUILT
	select BR2_PACKAGE_LIBSINGULARITY
	select BR2_PACKAGE_LIBGEE
	select BR2_PACKAGE_JSON_GLIB
	select BR2_PACKAGE_LIBPEAS2
	select BR2_PACKAGE_LIBSOUP3
	select BR2_PACKAGE_LIBXML2
	help
	  Singularity Media Plugins.

	  https://github.com/singularityos-lab/singularity-media-plugins
```

## package/singularity-messages/Config.in
```kconfig
config BR2_PACKAGE_SINGULARITY_MESSAGES
	bool "singularity-messages"
	depends on BR2_PACKAGE_LIBGTK4
	select BR2_PACKAGE_LIBSINGULARITY
	select BR2_PACKAGE_LIBGEE
	select BR2_PACKAGE_JSON_GLIB
	select BR2_PACKAGE_LIBSOUP3
	select BR2_PACKAGE_LIBPEAS2
	help
	  Singularity Messages: chats and collaboration history.

	  https://github.com/singularityos-lab/singularity-messages
```

## package/singularity-montage/Config.in
```kconfig
config BR2_PACKAGE_SINGULARITY_MONTAGE
	bool "singularity-montage"
	depends on BR2_PACKAGE_LIBGTK4
	select BR2_PACKAGE_LIBSINGULARITY
	select BR2_PACKAGE_CAIRO
	select BR2_PACKAGE_GDK_PIXBUF
	select BR2_PACKAGE_LIBGEE
	select BR2_PACKAGE_GSTREAMER1
	select BR2_PACKAGE_GST1_PLUGINS_BASE
	select BR2_PACKAGE_JSON_GLIB
	select BR2_PACKAGE_LIBXML2
	select BR2_PACKAGE_PANGO
	select BR2_PACKAGE_ZLIB
	help
	  Singularity Montage: edit video on a multitrack timeline and export for the web, social and masters.

	  https://github.com/singularityos-lab/singularity-montage
```

## package/singularity-nearby-app/Config.in
```kconfig
config BR2_PACKAGE_SINGULARITY_NEARBY_APP
	bool "singularity-nearby-app"
	depends on BR2_PACKAGE_LIBGTK4
	select BR2_PACKAGE_LIBSINGULARITY
	select BR2_PACKAGE_LIBGEE
	select BR2_PACKAGE_SINGULARITY_NEARBY
	help
	  Singularity Nearby: the app to send files to nearby devices.

	  https://github.com/singularityos-lab/singularity-nearby-app
```

## package/singularity-nearby/Config.in
```kconfig
config BR2_PACKAGE_SINGULARITY_NEARBY
	bool "singularity-nearby"
	depends on BR2_PACKAGE_LIBGTK4
	select BR2_PACKAGE_LIBGEE
	select BR2_PACKAGE_JSON_GLIB
	select BR2_PACKAGE_GNUTLS
	help
	  Singularity Nearby: discovery and pairing of nearby devices.

	  https://github.com/singularityos-lab/singularity-nearby
```

## package/singularity-news/Config.in
```kconfig
config BR2_PACKAGE_SINGULARITY_NEWS
	bool "singularity-news"
	depends on BR2_PACKAGE_LIBGTK4
	select BR2_PACKAGE_LIBSINGULARITY
	select BR2_PACKAGE_LIBGEE
	select BR2_PACKAGE_JSON_GLIB
	select BR2_PACKAGE_LIBSOUP3
	select BR2_PACKAGE_LIBXML2
	help
	  Singularity News: read the latest from your favorite sites.

	  https://github.com/singularityos-lab/singularity-news
```

## package/singularity-notes/Config.in
```kconfig
config BR2_PACKAGE_SINGULARITY_NOTES
	bool "singularity-notes"
	depends on BR2_PACKAGE_LIBGTK4
	select BR2_PACKAGE_LIBSINGULARITY
	select BR2_PACKAGE_LIBGEE
	select BR2_PACKAGE_GNUTLS
	select BR2_PACKAGE_GSTREAMER1
	select BR2_PACKAGE_JSON_GLIB
	select BR2_PACKAGE_LIBSOUP3
	select BR2_PACKAGE_LIBXML2
	select BR2_PACKAGE_PANGO
	select BR2_PACKAGE_POPPLER
	select BR2_PACKAGE_ZLIB
	help
	  Singularity Notes: notebooks with pages, drawings, tables, tags and recordings, synced with your accounts.

	  https://github.com/singularityos-lab/singularity-notes
```

## package/singularity-passwords/Config.in
```kconfig
config BR2_PACKAGE_SINGULARITY_PASSWORDS
	bool "singularity-passwords"
	depends on BR2_PACKAGE_LIBGTK4
	select BR2_PACKAGE_LIBSINGULARITY
	select BR2_PACKAGE_LIBGEE
	help
	  Singularity Passwords: keep and find your passwords.

	  https://github.com/singularityos-lab/singularity-passwords
```

## package/singularity-photos/Config.in
```kconfig
config BR2_PACKAGE_SINGULARITY_PHOTOS
	bool "singularity-photos"
	depends on BR2_PACKAGE_LIBGTK4
	select BR2_PACKAGE_LIBSINGULARITY
	select BR2_PACKAGE_LIBGEE
	select BR2_PACKAGE_LIBGPHOTO2
	select BR2_PACKAGE_WEBP
	select BR2_PACKAGE_WEBP_MUX
	select BR2_PACKAGE_TIFF
	help
	  Singularity Photos: the image viewer.

	  https://github.com/singularityos-lab/singularity-photos
```

## package/singularity-podcasts/Config.in
```kconfig
config BR2_PACKAGE_SINGULARITY_PODCASTS
	bool "singularity-podcasts"
	depends on BR2_PACKAGE_LIBGTK4
	select BR2_PACKAGE_LIBSINGULARITY
	select BR2_PACKAGE_GDK_PIXBUF
	select BR2_PACKAGE_LIBGEE
	select BR2_PACKAGE_GSTREAMER1
	select BR2_PACKAGE_JSON_GLIB
	select BR2_PACKAGE_LIBSOUP3
	select BR2_PACKAGE_LIBXML2
	help
	  Singularity Podcasts: listen to your favorite shows.

	  https://github.com/singularityos-lab/singularity-podcasts
```

## package/singularity-printers/Config.in
```kconfig
config BR2_PACKAGE_SINGULARITY_PRINTERS
	bool "singularity-printers"
	depends on BR2_PACKAGE_LIBGTK4
	select BR2_PACKAGE_LIBSINGULARITY
	select BR2_PACKAGE_LIBGEE
	help
	  Singularity Printers: follow print jobs and printer alerts.

	  https://github.com/singularityos-lab/singularity-printers
```

## package/singularity-publish/Config.in
```kconfig
config BR2_PACKAGE_SINGULARITY_PUBLISH
	bool "singularity-publish"
	depends on BR2_PACKAGE_LIBGTK4
	select BR2_PACKAGE_LIBSINGULARITY
	select BR2_PACKAGE_CAIRO
	select BR2_PACKAGE_FONTCONFIG
	select BR2_PACKAGE_GDK_PIXBUF
	select BR2_PACKAGE_LIBGEE
	select BR2_PACKAGE_LCMS2
	select BR2_PACKAGE_LIBRSVG
	select BR2_PACKAGE_LIBXML2
	select BR2_PACKAGE_PANGO
	select BR2_PACKAGE_POPPLER
	select BR2_PACKAGE_SQLITE
	select BR2_PACKAGE_ZLIB
	help
	  Singularity Publish: lay out flyers, brochures, newsletters and cards for print.

	  https://github.com/singularityos-lab/singularity-publish
```

## package/singularity-qrcodes/Config.in
```kconfig
config BR2_PACKAGE_SINGULARITY_QRCODES
	bool "singularity-qrcodes"
	depends on BR2_PACKAGE_LIBGTK4
	select BR2_PACKAGE_LIBSINGULARITY
	select BR2_PACKAGE_CAIRO
	select BR2_PACKAGE_GDK_PIXBUF
	select BR2_PACKAGE_LIBGEE
	select BR2_PACKAGE_GSTREAMER1
	select BR2_PACKAGE_GST1_PLUGINS_BASE
	select BR2_PACKAGE_JSON_GLIB
	select BR2_PACKAGE_LIBPEAS2
	select BR2_PACKAGE_ZBAR
	help
	  Singularity QR Codes: scan and create QR codes and barcodes.

	  https://github.com/singularityos-lab/singularity-qrcodes
```

## package/singularity-reader/Config.in
```kconfig
config BR2_PACKAGE_SINGULARITY_READER
	bool "singularity-reader"
	depends on BR2_PACKAGE_LIBGTK4
	select BR2_PACKAGE_LIBSINGULARITY
	select BR2_PACKAGE_CAIRO
	select BR2_PACKAGE_GDK_PIXBUF
	select BR2_PACKAGE_LIBGEE
	select BR2_PACKAGE_GNUTLS
	select BR2_PACKAGE_LIBPEAS2
	select BR2_PACKAGE_LIBSOUP3
	select BR2_PACKAGE_POPPLER
	select BR2_PACKAGE_ZLIB
	help
	  Singularity Reader: read, annotate and sign PDF documents.

	  https://github.com/singularityos-lab/singularity-reader
```

## package/singularity-scanner/Config.in
```kconfig
config BR2_PACKAGE_SINGULARITY_SCANNER
	bool "singularity-scanner"
	depends on BR2_PACKAGE_LIBGTK4
	select BR2_PACKAGE_LIBSINGULARITY
	select BR2_PACKAGE_CAIRO
	select BR2_PACKAGE_LIBGEE
	select BR2_PACKAGE_SANE_BACKENDS
	help
	  Singularity Scanner: scan documents and photos to PDF or images.

	  https://github.com/singularityos-lab/singularity-scanner
```
