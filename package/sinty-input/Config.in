## package/sinty-input/Config.in
```kconfig
config BR2_PACKAGE_SINTY_INPUT
	bool "sinty-input"
	depends on BR2_PACKAGE_HOST_GO_TARGET_ARCH_SUPPORTS
	help
	  The input method service of SintyOS: Chinese, Japanese,
	  Korean and Vietnamese engines on dev.sinty.Input1.

	  https://github.com/singularityos-lab/sinty-input
```

## package/sinty-keyd/Config.in
```kconfig
config BR2_PACKAGE_SINTY_KEYD
	bool "sinty-keyd"
	depends on BR2_PACKAGE_HOST_GO_TARGET_ARCH_SUPPORTS
	select BR2_PACKAGE_SINTY_CRYPTO
	help
	  The Sinty Key service of SintyOS: encrypted USB Keys
	  unlocked with a PIN, sealed in the TPM of remembered
	  computers, on dev.sinty.Key1.

	  https://github.com/singularityos-lab/sinty-keyd
```

## package/sinty-locale/Config.in
```kconfig
config BR2_PACKAGE_SINTY_LOCALE
	bool "sinty-locale"
	depends on BR2_PACKAGE_HOST_GO_TARGET_ARCH_SUPPORTS
	depends on BR2_PACKAGE_HOST_GO_TARGET_CGO_LINKING_SUPPORTS
	help
	  Native localectl and locale1 replacement for SintyOS
	  (de-systemd). Serves org.freedesktop.locale1 so Settings
	  can show and change the system language and keyboard, and
	  keeps them in /var/lib/singularity because /etc is
	  read-only. Installed as /usr/bin/sinty-locale and wired as
	  /usr/bin/localectl by the post-build script.

	  https://github.com/singularityos-lab/sinty-locale
```

## package/sinty-logind/Config.in
```kconfig
config BR2_PACKAGE_SINTY_LOGIND
	bool "sinty-logind"
	depends on BR2_PACKAGE_HOST_GO_TARGET_ARCH_SUPPORTS
	depends on BR2_PACKAGE_HOST_GO_TARGET_CGO_LINKING_SUPPORTS
	depends on BR2_PACKAGE_LINUX_PAM
	help
	  Login, session and seat manager for SintyOS (de-systemd). Runs
	  the login screen over the greetd protocol, serves the seatd
	  protocol for libseat compositors and org.freedesktop.login1
	  for power, sessions and the seat.

	  https://github.com/singularityos-lab/sinty-logind
```

## package/sinty-media-prebuilt/Config.in
```kconfig
config BR2_PACKAGE_SINTY_MEDIA_PREBUILT
	bool "sinty-media-prebuilt"
	depends on BR2_x86_64
	select BR2_PACKAGE_GSTREAMER1
	select BR2_PACKAGE_GST1_PLUGINS_BASE
	select BR2_PACKAGE_GST1_PLUGINS_GOOD
	help
	  Sinty media: the in-house GStreamer 1.28 compatible core libraries, plugins and media service.
```

## package/sinty-media/Config.in
```kconfig
config BR2_PACKAGE_SINTY_MEDIA
	bool "sinty-media"
	depends on BR2_aarch64
	select BR2_PACKAGE_GSTREAMER1
	select BR2_PACKAGE_GST1_PLUGINS_BASE
	select BR2_PACKAGE_GST1_PLUGINS_GOOD
	select BR2_PACKAGE_PIPEWIRE
	select BR2_PACKAGE_PANGO
	select BR2_PACKAGE_LIBGUDEV
	select BR2_PACKAGE_LIBDRM
	select BR2_PACKAGE_GRAPHENE
	select BR2_PACKAGE_LIBPNG
	select BR2_PACKAGE_JPEG
	select BR2_PACKAGE_LIBOGG
	select BR2_PACKAGE_ZLIB
	select BR2_PACKAGE_WAYLAND
	select BR2_PACKAGE_XLIB_LIBXI if BR2_PACKAGE_XORG7
	select BR2_PACKAGE_XLIB_LIBXV if BR2_PACKAGE_XORG7
	select BR2_PACKAGE_XLIB_LIBXEXT if BR2_PACKAGE_XORG7
	help
	  Sinty media built from source: the in-house GStreamer 1.28
	  compatible core libraries, plugins and media service, with
	  the same files as the x86_64 prebuilt.
```

## package/sinty-nmd/Config.in
```kconfig
config BR2_PACKAGE_SINTY_NMD
	bool "sinty-nmd"
	depends on BR2_PACKAGE_HOST_GO_TARGET_ARCH_SUPPORTS
	help
	  sinty-nmd: the Sinty OS network manager daemon, built from the
	  sinty-nm sources against the Sinty system core. Installs
	  /usr/bin/sinty-nmd.

	  https://github.com/singularityos-lab/sinty-nm
```

## package/sinty-parentald/Config.in
```kconfig
config BR2_PACKAGE_SINTY_PARENTALD
	bool "sinty-parentald"
	depends on BR2_PACKAGE_HOST_GO_TARGET_ARCH_SUPPORTS
	help
	  Keeps the parental controls policy of each account and lets
	  an administrator change it over D-Bus (dev.sinty.Parental1),
	  in place of a pkexec helper.

	  https://github.com/singularityos-lab/sinty-parentald
```

## package/sinty-powerd/Config.in
```kconfig
config BR2_PACKAGE_SINTY_POWERD
	bool "sinty-powerd"
	depends on BR2_PACKAGE_HOST_GO_TARGET_ARCH_SUPPORTS
	help
	  The power daemon of SintyOS: batteries and power supplies on
	  org.freedesktop.UPower, the power profiles of
	  power-profiles-daemon and a thermal guard, in one process.
	  Replaces the UPower daemon, power-profiles-daemon and
	  thermald; libupower-glib stays for its clients.

	  https://github.com/singularityos-lab/sinty-powerd
```

## package/sinty-recoverd/Config.in
```kconfig
config BR2_PACKAGE_SINTY_RECOVERD
	bool "sinty-recoverd"
	help
	  Root daemon: the recovery escape hatch for the pre-login greeter.
	  Performs `sintykey recover` on behalf of the unprivileged greeter,
	  gated by the recovery code, over a unix socket.
```

## package/sinty-recovery-ui/Config.in
```kconfig
config BR2_PACKAGE_SINTY_RECOVERY_UI
	bool "sinty-recovery-ui"
	select BR2_PACKAGE_CAIRO
	select BR2_PACKAGE_PANGO
	select BR2_PACKAGE_GDK_PIXBUF
	select BR2_PACKAGE_WAYLAND
	select BR2_PACKAGE_LIBDRM
	select BR2_PACKAGE_LIBINPUT
	select BR2_PACKAGE_LIBXKBCOMMON
	help
	  The graphical recovery front-end: a toolkit-less KMS-direct wifi
	  picker, progress view and Reinstall / Repair / Wipe menu, rendered
	  with Cairo through the shared singularity-loginui renderer, exactly
	  like singularity-boot-splash. Drives the recovery Core over the
	  atom-recovery local API.

	  https://github.com/singularityos-lab/sinty-recovery
```

## package/sinty-scheduler/Config.in
```kconfig
config BR2_PACKAGE_SINTY_SCHEDULER
	bool "sinty-scheduler"
	depends on BR2_LINUX_KERNEL
	depends on BR2_x86_64
	select BR2_PACKAGE_LIBGLIB2
	help
	  Workload scheduler: kernel module and daemon.

	  https://github.com/singularityos-lab/sinty-scheduler
```

## package/sinty-sdb/Config.in
```kconfig
config BR2_PACKAGE_SINTY_SDB
	bool "sinty-sdb"
	depends on BR2_PACKAGE_HOST_GO_TARGET_ARCH_SUPPORTS
	depends on BR2_PACKAGE_HOST_GO_TARGET_CGO_LINKING_SUPPORTS
	help
	  The Sinty Debug Bridge: sdbd (daemon) and sdb (client), a
	  TLS 1.3 ed25519 bridge with reciprocal pinning that replaces
	  the USB cable for development devices.

	  The daemon is off by default. It starts only after the owner
	  enables the bridge in Settings, which creates the persistent
	  device-policy marker /var/lib/sinty-sdb/enabled. Release images
	  expose the control but carry no network listener until opt-in.

	  https://github.com/singularityos-lab/sinty-sdb
```

## package/sinty-sh/Config.in
```kconfig
config BR2_PACKAGE_SINTY_SH
	bool "sinty-sh"
	depends on BR2_PACKAGE_HOST_GO_TARGET_ARCH_SUPPORTS
	help
	  The system /bin/sh of SintyOS: a POSIX shell for scripts on
	  the same Go interpreter as ush, with real background jobs,
	  signal traps and policies for scripts running as root.
	  Installed as /usr/bin/sinty-sh and wired as /bin/sh by the
	  post-build script.

	  https://github.com/singularityos-lab/sinty-sh
```

## package/sinty-speechd/Config.in
```kconfig
config BR2_PACKAGE_SINTY_SPEECHD
	bool "sinty-speechd"
	depends on BR2_PACKAGE_HOST_GO_TARGET_ARCH_SUPPORTS
	select BR2_PACKAGE_ESPEAK_NG
	help
	  The speech service of SintyOS: Piper and eSpeak NG voices
	  on dev.sinty.Speech1 and on the speech-dispatcher socket.

	  https://github.com/singularityos-lab/sinty-speechd
```

## package/sinty-sxi/Config.in
```kconfig
config BR2_PACKAGE_SINTY_SXI
	bool "sinty-sxi"
	depends on BR2_PACKAGE_HOST_GO_TARGET_ARCH_SUPPORTS
	help
	  SXI applications on SintyOS: sxid installs signed application
	  images from the collections the system trusts, maps them
	  through dm-verity and adds them to the launcher. sxi is the
	  publisher tool and the command line client.

	  https://github.com/singularityos-lab/sinty-sxi
```

## package/sinty-tessdata/Config.in
```kconfig
config BR2_PACKAGE_SINTY_TESSDATA
	bool "sinty-tessdata"
	depends on BR2_PACKAGE_TESSERACT_OCR
	help
	  Fast Tesseract models for the languages Sinty OS ships
	  (English, Italian, German, French, Spanish, Portuguese), used
	  by Text Recognition in Photos, Camera, Videos and previews.
```

## package/sinty-timedate/Config.in
```kconfig
config BR2_PACKAGE_SINTY_TIMEDATE
	bool "sinty-timedate"
	depends on BR2_PACKAGE_HOST_GO_TARGET_ARCH_SUPPORTS
	depends on BR2_PACKAGE_HOST_GO_TARGET_CGO_LINKING_SUPPORTS
	help
	  Native timedatectl replacement for SintyOS (de-systemd). The
	  stock systemd timedatectl refuses to operate without systemd
	  as PID 1; this drop-in queries and sets the same fields via
	  the Sinty stack. Installed as /usr/bin/sinty-timedate and
	  wired as /usr/bin/timedatectl by the post-build script.

	  https://github.com/singularityos-lab/sinty-timedate
```

## package/sinty-xwayland-prebuilt/Config.in
```kconfig
config BR2_PACKAGE_SINTY_XWAYLAND_PREBUILT
	bool "sinty-xwayland-prebuilt"
	depends on BR2_x86_64
	select BR2_PACKAGE_XWAYLAND
	help
	  Xwayland build of the session with its private libraries.
```

## package/torchio/Config.in
```kconfig
config BR2_PACKAGE_TORCHIO
	bool "torchio"
	depends on BR2_PACKAGE_HOST_GO_TARGET_ARCH_SUPPORTS
	help
	  torchio, the per-user print system that replaces cupsd. It
	  serves the CUPS protocol on the session's CUPS_SERVER socket,
	  so libcups applications and the CUPS command line tools work
	  unchanged. Removes cupsd and its filters from the image.

	  https://github.com/singularityos-lab/torchio
```

## package/ush/Config.in
```kconfig
config BR2_PACKAGE_USH
	bool "ush (permission broker + dsh developer shell)"
	depends on BR2_PACKAGE_HOST_GO_TARGET_ARCH_SUPPORTS
	help
	  USH permission broker and the dsh developer shell (rootless
	  podman/distrobox dev profile). Dev-image only.
```

## package/uutils-coreutils/Config.in
```kconfig
config BR2_PACKAGE_UUTILS_COREUTILS
	bool "uutils-coreutils"
	depends on BR2_PACKAGE_HOST_RUSTC_TARGET_ARCH_SUPPORTS
	select BR2_PACKAGE_HOST_RUSTC
	help
	  The GNU core utilities rewritten in Rust (uutils), built as a
	  single multicall binary with a link for every utility. Replaces
	  GNU coreutils and the BusyBox applets of the same names.

	  https://github.com/uutils/coreutils
```

## package/whisper-cpp/Config.in
```kconfig
config BR2_PACKAGE_WHISPER_CPP
	bool "whisper-cpp"
	depends on BR2_INSTALL_LIBSTDCPP
	depends on BR2_TOOLCHAIN_HAS_THREADS
	help
	  Offline speech recognition (whisper.cpp). Provides whisper-cli
	  for Dictation in the shell and transcription in Voice; the
	  speech models are downloaded from Settings.

	  https://github.com/ggml-org/whisper.cpp
```

## package/wl-clipboard/Config.in
```kconfig
config BR2_PACKAGE_WL_CLIPBOARD
	bool "wl-clipboard"
	depends on BR2_PACKAGE_WAYLAND
	help
	  Command-line copy and paste for Wayland (wl-copy, wl-paste),
	  used by terminal programs and by the ush and dsh sessions.

	  https://github.com/bugaevc/wl-clipboard
```
