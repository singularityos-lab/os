## package/mts/Config.in
```kconfig
config BR2_PACKAGE_MTS
	bool "mts (memory tiering standard userspace)"
	help
	  Memory Tiering Standard userspace: the mtsd daemon that
	  registers declarative cgroup-v2 tiers and admits domains, and
	  the mtsctl control tool. Requires the MTS kernel patches
	  (CONFIG_MTS_OBSERVE / CONFIG_MTS_TIER) which expose /dev/mts.
	  Built with Zig 0.16.x (host).
```

## package/mythes-data/Config.in
```kconfig
config BR2_PACKAGE_MYTHES_DATA
	bool "mythes-data"
	help
	  MyThes thesaurus data (English and Italian) from the
	  LibreOffice dictionaries, used by Singularity Write.

	  https://github.com/LibreOffice/dictionaries
```

## package/noto-color-emoji/Config.in
```kconfig
config BR2_PACKAGE_NOTO_COLOR_EMOJI
	bool "noto-color-emoji"
	help
	  Noto Color Emoji font, so emoji in terminals, prompts and
	  applications render instead of showing empty boxes.

	  https://github.com/googlefonts/noto-emoji
```

## package/noto-sans-symbols/Config.in
```kconfig
config BR2_PACKAGE_NOTO_SANS_SYMBOLS
	bool "noto-sans-symbols"
	help
	  Noto Sans Symbols, Symbols 2 and Math: technical, arrow,
	  dingbat and math symbols used by terminal interfaces.

	  https://notofonts.github.io/
```

## package/nvidia-l4t-userspace/Config.in
```kconfig
config BR2_PACKAGE_NVIDIA_L4T_USERSPACE
	bool "nvidia-l4t-userspace"
	depends on BR2_aarch64
	depends on BR2_PACKAGE_LINUX_L4T
	select BR2_PACKAGE_LIBGLVND
	help
	  The NVIDIA Jetson Linux r36 graphics and multimedia stack
	  for Orin: EGL, OpenGL ES and Vulkan through libglvnd, the
	  GBM backend and the Wayland platform for the compositor,
	  the V4L2 video encoder and decoder libraries and the GPU
	  and engine firmware. Other boards keep Mesa.

	  https://developer.nvidia.com/embedded/jetson-linux
```

## package/nvidia-open-modules/Config.in
```kconfig
config BR2_PACKAGE_NVIDIA_OPEN_MODULES
	bool "nvidia-open-modules"
	depends on BR2_LINUX_KERNEL
	depends on BR2_x86_64
	help
	  NVIDIA open GPU kernel modules for Turing and newer GPUs,
	  built against the shipped kernel so the build signs them.
	  They only load when the NVIDIA driver bundle of the same
	  version provides the user space libraries and the GSP
	  firmware.

	  https://github.com/NVIDIA/open-gpu-kernel-modules

comment "nvidia-open-modules needs a Linux kernel to be built"
	depends on BR2_x86_64
	depends on !BR2_LINUX_KERNEL
```

## package/pam-rundir/Config.in
```kconfig
config BR2_PACKAGE_PAM_RUNDIR
	bool "pam-rundir"
	depends on BR2_PACKAGE_LINUX_PAM
	help
	  Minimal PAM session module that creates and owns /run/user/$UID
	  and exports XDG_RUNTIME_DIR at login, for systems without
	  systemd-logind.
```

## package/polkit127-prebuilt/Config.in
```kconfig
config BR2_PACKAGE_POLKIT127_PREBUILT
	bool "polkit127-prebuilt"
	depends on BR2_x86_64
	select BR2_PACKAGE_POLKIT
	help
	  polkit 127 with the socket activated agent helper.
```

## package/power-profiles-daemon/Config.in
```kconfig
config BR2_PACKAGE_POWER_PROFILES_DAEMON
	bool "power-profiles-daemon"
	depends on BR2_USE_WCHAR # libglib2
	depends on BR2_TOOLCHAIN_HAS_THREADS # libglib2
	depends on BR2_USE_MMU # libglib2
	depends on BR2_PACKAGE_HAS_UDEV # libgudev
	select BR2_PACKAGE_LIBGLIB2
	select BR2_PACKAGE_LIBGUDEV
	help
	  power-profiles-daemon offers to modify system behaviour
	  based upon user-selected power profiles (power-saver,
	  balanced, performance) over the net.hadess.PowerProfiles
	  D-Bus interface, driving intel_pstate EPP and ACPI
	  platform_profile backends.

	  https://gitlab.freedesktop.org/upower/power-profiles-daemon
```

## package/singularity-accounts/Config.in
```kconfig
config BR2_PACKAGE_SINGULARITY_ACCOUNTS
	bool "singularity-accounts"
	depends on BR2_PACKAGE_LIBGTK4
	depends on BR2_PACKAGE_WEBKITGTK || BR2_PACKAGE_WEBKITGTK_PREBUILT
	select BR2_PACKAGE_LIBSINGULARITY
	select BR2_PACKAGE_LIBFUSE3
	select BR2_PACKAGE_LIBGEE
	select BR2_PACKAGE_JSON_GLIB
	select BR2_PACKAGE_LIBSECRET
	select BR2_PACKAGE_LIBSOUP3
	help
	  Singularity Accounts: sign in to an online account.

	  https://github.com/singularityos-lab/singularity-accounts
```

## package/singularity-atelier/Config.in
```kconfig
config BR2_PACKAGE_SINGULARITY_ATELIER
	bool "singularity-atelier"
	depends on BR2_PACKAGE_LIBGTK4
	select BR2_PACKAGE_LIBSINGULARITY
	select BR2_PACKAGE_CAIRO
	select BR2_PACKAGE_GDK_PIXBUF
	select BR2_PACKAGE_LIBGEE
	select BR2_PACKAGE_GSTREAMER1
	select BR2_PACKAGE_JSON_GLIB
	select BR2_PACKAGE_LCMS2
	select BR2_PACKAGE_LIBPEAS2
	select BR2_PACKAGE_LIBXML2
	select BR2_PACKAGE_PANGO
	select BR2_PACKAGE_ZLIB
	help
	  Singularity Atelier: sketch, make patterns, grade sizes and prepare tech packs.

	  https://github.com/singularityos-lab/singularity-atelier
```

## package/singularity-authenticator/Config.in
```kconfig
config BR2_PACKAGE_SINGULARITY_AUTHENTICATOR
	bool "singularity-authenticator"
	depends on BR2_PACKAGE_LIBGTK4
	select BR2_PACKAGE_LIBSINGULARITY
	select BR2_PACKAGE_CAIRO
	select BR2_PACKAGE_GDK_PIXBUF
	select BR2_PACKAGE_LIBGEE
	select BR2_PACKAGE_JSON_GLIB
	select BR2_PACKAGE_LIBGCRYPT
	select BR2_PACKAGE_LIBSECRET
	select BR2_PACKAGE_LIBSOUP3
	select BR2_PACKAGE_ZBAR
	help
	  Singularity Authenticator: two-factor sign-in codes for your accounts.

	  https://github.com/singularityos-lab/singularity-authenticator
```

## package/singularity-backups/Config.in
```kconfig
config BR2_PACKAGE_SINGULARITY_BACKUPS
	bool "singularity-backups"
	depends on BR2_PACKAGE_LIBGTK4
	select BR2_PACKAGE_LIBSINGULARITY
	select BR2_PACKAGE_LIBGEE
	select BR2_PACKAGE_JSON_GLIB
	select BR2_PACKAGE_LIBPEAS2
	select BR2_PACKAGE_LIBSECRET
	help
	  Singularity Backups: runs scheduled backups in the background.

	  https://github.com/singularityos-lab/singularity-backups
```

## package/singularity-browser/Config.in
```kconfig
config BR2_PACKAGE_SINGULARITY_BROWSER
	bool "singularity-browser"
	depends on BR2_PACKAGE_LIBGTK4
	depends on BR2_PACKAGE_WEBKITGTK || BR2_PACKAGE_WEBKITGTK_PREBUILT
	select BR2_PACKAGE_LIBSINGULARITY
	select BR2_PACKAGE_LIBGEE
	select BR2_PACKAGE_GNUTLS
	select BR2_PACKAGE_JSON_GLIB
	select BR2_PACKAGE_LIBFIDO2
	select BR2_PACKAGE_LIBSECRET
	select BR2_PACKAGE_LIBSOUP3
	select BR2_PACKAGE_LIBXML2
	select BR2_PACKAGE_POLKIT
	select BR2_PACKAGE_POPPLER
	select BR2_PACKAGE_SQLITE
	help
	  Singularity Browser: browse the web with tiles, tabs and bubbles.

	  https://github.com/singularityos-lab/singularity-browser
```

## package/singularity-camera/Config.in
```kconfig
config BR2_PACKAGE_SINGULARITY_CAMERA
	bool "singularity-camera"
	depends on BR2_PACKAGE_LIBGTK4
	select BR2_PACKAGE_LIBSINGULARITY
	select BR2_PACKAGE_LIBGEE
	select BR2_PACKAGE_GSTREAMER1
	select BR2_PACKAGE_GST1_PLUGINS_BASE
	select BR2_PACKAGE_LIBPEAS2
	help
	  Singularity Camera: take photos and record videos.

	  https://github.com/singularityos-lab/singularity-camera
```

## package/singularity-characters/Config.in
```kconfig
config BR2_PACKAGE_SINGULARITY_CHARACTERS
	bool "singularity-characters"
	depends on BR2_PACKAGE_LIBGTK4
	select BR2_PACKAGE_LIBSINGULARITY
	select BR2_PACKAGE_LIBGEE
	help
	  Singularity Characters: find and copy special characters and emoji.

	  https://github.com/singularityos-lab/singularity-characters
```

## package/singularity-clock/Config.in
```kconfig
config BR2_PACKAGE_SINGULARITY_CLOCK
	bool "singularity-clock"
	depends on BR2_PACKAGE_LIBGTK4
	select BR2_PACKAGE_LIBSINGULARITY
	select BR2_PACKAGE_LIBGEE
	select BR2_PACKAGE_LIBPEAS2
	help
	  Singularity Clock: alarms, world clocks, stopwatch and timer.

	  https://github.com/singularityos-lab/singularity-clock
```

## package/singularity-colorpicker/Config.in
```kconfig
config BR2_PACKAGE_SINGULARITY_COLORPICKER
	bool "singularity-colorpicker"
	depends on BR2_PACKAGE_LIBGTK4
	select BR2_PACKAGE_LIBSINGULARITY
	select BR2_PACKAGE_LIBGEE
	select BR2_PACKAGE_JSON_GLIB
	select BR2_PACKAGE_LIBPEAS2
	help
	  Singularity Color Picker: pick colors from the screen and convert them between formats.

	  https://github.com/singularityos-lab/singularity-colorpicker
```

## package/singularity-connections/Config.in
```kconfig
config BR2_PACKAGE_SINGULARITY_CONNECTIONS
	bool "singularity-connections"
	depends on BR2_PACKAGE_LIBGTK4
	select BR2_PACKAGE_LIBSINGULARITY
	select BR2_PACKAGE_LIBGEE
	select BR2_PACKAGE_JSON_GLIB
	select BR2_PACKAGE_LIBSECRET
	help
	  Singularity Connections: see and control other computers over VNC and RDP.

	  https://github.com/singularityos-lab/singularity-connections
```

## package/singularity-contacts/Config.in
```kconfig
config BR2_PACKAGE_SINGULARITY_CONTACTS
	bool "singularity-contacts"
	depends on BR2_PACKAGE_LIBGTK4
	select BR2_PACKAGE_LIBSINGULARITY
	select BR2_PACKAGE_LIBGEE
	help
	  Singularity Contacts: the people you know.

	  https://github.com/singularityos-lab/singularity-contacts
```

## package/singularity-database/Config.in
```kconfig
config BR2_PACKAGE_SINGULARITY_DATABASE
	bool "singularity-database"
	depends on BR2_PACKAGE_LIBGTK4
	select BR2_PACKAGE_LIBSINGULARITY
	select BR2_PACKAGE_CAIRO
	select BR2_PACKAGE_GDK_PIXBUF
	select BR2_PACKAGE_LIBGEE
	select BR2_PACKAGE_GTKSOURCEVIEW
	select BR2_PACKAGE_JSON_GLIB
	select BR2_PACKAGE_LIBSECRET
	select BR2_PACKAGE_LIBXML2
	select BR2_PACKAGE_NETTLE
	select BR2_PACKAGE_PANGO
	select BR2_PACKAGE_SQLITE
	select BR2_PACKAGE_SQLITE_ENABLE_COLUMN_METADATA
	select BR2_PACKAGE_ZLIB
	help
	  Singularity Database: build databases with tables, queries, forms and reports.

	  https://github.com/singularityos-lab/singularity-database
```

## package/singularity-demo/Config.in
```kconfig
config BR2_PACKAGE_SINGULARITY_DEMO
	bool "singularity-demo"
	depends on BR2_PACKAGE_LIBGTK4
	select BR2_PACKAGE_LIBSINGULARITY
	select BR2_PACKAGE_LIBGEE
	select BR2_PACKAGE_LIBSECRET
	help
	  Singularity Demo: libsingularity widget showcase.

	  https://github.com/singularityos-lab/singularity-demo
```

## package/singularity-disks/Config.in
```kconfig
config BR2_PACKAGE_SINGULARITY_DISKS
	bool "singularity-disks"
	depends on BR2_PACKAGE_LIBGTK4
	select BR2_PACKAGE_LIBSINGULARITY
	select BR2_PACKAGE_LIBGEE
	select BR2_PACKAGE_LIBPEAS2
	help
	  Singularity Disks: manage drives, partitions and disk images.

	  https://github.com/singularityos-lab/singularity-disks
```

## package/singularity-drivewriter/Config.in
```kconfig
config BR2_PACKAGE_SINGULARITY_DRIVEWRITER
	bool "singularity-drivewriter"
	depends on BR2_PACKAGE_LIBGTK4
	select BR2_PACKAGE_LIBSINGULARITY
	select BR2_PACKAGE_LIBGEE
	select BR2_PACKAGE_XZ
	select BR2_PACKAGE_ZSTD
	help
	  Singularity Drive Writer: write disk images to USB drives and memory cards.

	  https://github.com/singularityos-lab/singularity-drivewriter
```

## package/singularity-fediverse/Config.in
```kconfig
config BR2_PACKAGE_SINGULARITY_FEDIVERSE
	bool "singularity-fediverse"
	depends on BR2_PACKAGE_LIBGTK4
	select BR2_PACKAGE_LIBSINGULARITY
	select BR2_PACKAGE_LIBGEE
	select BR2_PACKAGE_JSON_GLIB
	select BR2_PACKAGE_LIBPEAS2
	select BR2_PACKAGE_LIBSECRET
	select BR2_PACKAGE_LIBSOUP3
	help
	  Singularity Fediverse: follow people on Mastodon and the social web.

	  https://github.com/singularityos-lab/singularity-fediverse
```
