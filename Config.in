## buildroot-config/singularity_defconfig
```kconfig
BR2_x86_64=y
BR2_REPRODUCIBLE=y
BR2_TOOLCHAIN_BUILDROOT_CXX=y
BR2_TARGET_GENERIC_HOSTNAME="sinty"
BR2_TARGET_GENERIC_ISSUE="Sinty OS Event Horizon 26"
BR2_INIT_NONE=y
BR2_ROOTFS_DEVICE_CREATION_DYNAMIC_EUDEV=y
BR2_ROOTFS_MERGED_USR=y
BR2_ROOTFS_MERGED_BIN=y
BR2_ENABLE_LOCALE_WHITELIST="C en_US it_IT es_ES fr_FR de_DE pt_BR"
BR2_GENERATE_LOCALE="it_IT.UTF-8 en_US.UTF-8 es_ES.UTF-8 fr_FR.UTF-8 de_DE.UTF-8 pt_BR.UTF-8"
BR2_TARGET_TZ_INFO=y
BR2_ROOTFS_USERS_TABLES="$(BR2_EXTERNAL_SINGULARITY_PATH)/board/users.txt"
BR2_ROOTFS_OVERLAY="$(BR2_EXTERNAL_SINGULARITY_PATH)/rootfs-overlay"
BR2_ROOTFS_POST_BUILD_SCRIPT="$(BR2_EXTERNAL_SINGULARITY_PATH)/scripts/post-build.sh"
BR2_ROOTFS_POST_IMAGE_SCRIPT="$(BR2_EXTERNAL_SINGULARITY_PATH)/scripts/post-image.sh"
BR2_LINUX_KERNEL=y
BR2_LINUX_KERNEL_CUSTOM_VERSION=y
BR2_LINUX_KERNEL_CUSTOM_VERSION_VALUE="7.2.11"
BR2_LINUX_KERNEL_USE_CUSTOM_CONFIG=y
BR2_LINUX_KERNEL_CUSTOM_CONFIG_FILE="$(BR2_EXTERNAL_SINGULARITY_PATH)/buildroot-config/kernel.config"
BR2_LINUX_KERNEL_CONFIG_FRAGMENT_FILES="$(BR2_EXTERNAL_SINGULARITY_PATH)/board/mts/linux-mts.fragment"
BR2_LINUX_KERNEL_PATCH="$(BR2_EXTERNAL_SINGULARITY_PATH)/board/mts/linux-patches"
BR2_LINUX_KERNEL_NEEDS_HOST_LIBELF=y
BR2_PACKAGE_ATOM_FIRSTBOOT=y
BR2_PACKAGE_ATOMLOOPS=y
BR2_PACKAGE_PAM_RUNDIR=y
BR2_PACKAGE_MTS=y
# Toolchain kernel-headers are pinned to 6.19 (the newest Buildroot 2026.02.2
# knows) instead of tracking the 7.2.11 kernel image: Buildroot has no
# headers-version mapping for 7.x, so AS_KERNEL leaves BR2_TOOLCHAIN_HEADERS_AT_LEAST
# at the 2.6 floor and check-kernel-headers.sh aborts ("expected 2.6.x, got 7.x").
# 6.19 userspace headers run fine on a 7.2.11 kernel (backward compatible).
BR2_KERNEL_HEADERS_6_19=y
# BR2_PACKAGE_BUSYBOX is not set
BR2_PACKAGE_GSTREAMER1=y
BR2_PACKAGE_GST1_PLUGINS_GOOD=y
BR2_PACKAGE_GST1_PLUGINS_GOOD_PLUGIN_AUDIOPARSERS=y
BR2_PACKAGE_GST1_PLUGINS_BAD=y
BR2_PACKAGE_GST1_PLUGINS_BAD_PLUGIN_VIDEOPARSERS=y
BR2_PACKAGE_GST1_LIBAV=y
BR2_PACKAGE_WIREPLUMBER=y
BR2_PACKAGE_GDB=y
BR2_PACKAGE_LSOF=y
BR2_PACKAGE_STRACE=y
BR2_PACKAGE_DOSFSTOOLS=y
BR2_PACKAGE_F2FS_TOOLS=y
BR2_PACKAGE_FUSE_OVERLAYFS=y
BR2_PACKAGE_DEJAVU=y
BR2_PACKAGE_MESA3D=y
BR2_PACKAGE_MESA3D_LLVM=y
BR2_PACKAGE_MESA3D_GALLIUM_DRIVER_CROCUS=y
BR2_PACKAGE_MESA3D_GALLIUM_DRIVER_IRIS=y
BR2_PACKAGE_MESA3D_GALLIUM_DRIVER_LLVMPIPE=y
BR2_PACKAGE_MESA3D_GALLIUM_DRIVER_NOUVEAU=y
BR2_PACKAGE_MESA3D_GALLIUM_DRIVER_R600=y
BR2_PACKAGE_MESA3D_GALLIUM_DRIVER_RADEONSI=y
BR2_PACKAGE_MESA3D_GALLIUM_DRIVER_VIRGL=y
BR2_PACKAGE_MESA3D_GALLIUM_DRIVER_ZINK=y
BR2_PACKAGE_MESA3D_VULKAN_DRIVER_INTEL=y
BR2_PACKAGE_MESA3D_VULKAN_DRIVER_SWRAST=y
BR2_PACKAGE_MESA3D_VULKAN_DRIVER_VIRTIO=y
BR2_PACKAGE_MESA3D_OPENGL_ES=y
BR2_PACKAGE_XORG7=y
BR2_PACKAGE_XWAYLAND=y
BR2_PACKAGE_XCB_UTIL_WM=y
BR2_PACKAGE_XAPP_XRDB=y
BR2_PACKAGE_XKEYBOARD_CONFIG=y
BR2_PACKAGE_LINUX_FIRMWARE=y
BR2_PACKAGE_LINUX_FIRMWARE_AMD_UCODE=y
BR2_PACKAGE_LINUX_FIRMWARE_AMDGPU=y
BR2_PACKAGE_LINUX_FIRMWARE_I915=y
BR2_PACKAGE_LINUX_FIRMWARE_RADEON=y
BR2_PACKAGE_LINUX_FIRMWARE_MEDIATEK_MT7921_BT=y
BR2_PACKAGE_LINUX_FIRMWARE_MEDIATEK_MT7922_BT=y
BR2_PACKAGE_LINUX_FIRMWARE_RTL_88XX_BT=y
BR2_PACKAGE_LINUX_FIRMWARE_ATHEROS_10K_QCA9377=y
BR2_PACKAGE_LINUX_FIRMWARE_ATHEROS_10K_QCA998X=y
BR2_PACKAGE_LINUX_FIRMWARE_BRCM_BCM43XXX=y
BR2_PACKAGE_LINUX_FIRMWARE_IWLWIFI_22000=y
BR2_PACKAGE_LINUX_FIRMWARE_IWLWIFI_7265D=y
BR2_PACKAGE_LINUX_FIRMWARE_IWLWIFI_8265=y
BR2_PACKAGE_LINUX_FIRMWARE_IWLWIFI_9XXX=y
BR2_PACKAGE_LINUX_FIRMWARE_IWLWIFI_6E=y
BR2_PACKAGE_GVFS=y
BR2_PACKAGE_INTEL_MICROCODE=y
BR2_PACKAGE_KBD=y
BR2_PACKAGE_PCIUTILS=y
BR2_PACKAGE_UDISKS=y
BR2_PACKAGE_USBUTILS=y
BR2_PACKAGE_LUA=y
BR2_PACKAGE_PYTHON3=y
BR2_PACKAGE_PYTHON3_ZLIB=y
BR2_PACKAGE_PYTHON3_XZ=y
BR2_PACKAGE_PYTHON3_PYEXPAT=y
BR2_PACKAGE_PYTHON3_SQLITE=y
BR2_PACKAGE_PYTHON3_SSL=y
BR2_PACKAGE_PYTHON3_READLINE=y
BR2_PACKAGE_PYTHON3_CURSES=y
BR2_PACKAGE_PYTHON3_BZIP2=y
BR2_PACKAGE_ALSA_LIB=y
BR2_PACKAGE_CA_CERTIFICATES=y
BR2_PACKAGE_GNUTLS=y
BR2_PACKAGE_LIBGTK4=y
BR2_PACKAGE_GLIB_NETWORKING=y
BR2_PACKAGE_GOBJECT_INTROSPECTION=y
BR2_PACKAGE_BLUEZ5_UTILS=y
BR2_PACKAGE_BLUEZ5_UTILS_CLIENT=y
BR2_PACKAGE_BLUEZ5_UTILS_TOOLS=y
BR2_PACKAGE_BLUEZ5_UTILS_PLUGINS_HID=y
BR2_PACKAGE_CHRONY=y
BR2_PACKAGE_DROPBEAR=y
BR2_PACKAGE_ETHTOOL=y
BR2_PACKAGE_HOSTAPD=y
BR2_PACKAGE_IPROUTE2=y
BR2_PACKAGE_IW=y
BR2_PACKAGE_IWD=y
BR2_PACKAGE_NETWORK_MANAGER_CLI=y
BR2_PACKAGE_PASST=y
BR2_PACKAGE_TCPDUMP=y
BR2_PACKAGE_WIRELESS_REGDB=y
BR2_PACKAGE_WPA_SUPPLICANT=y
BR2_PACKAGE_WPA_SUPPLICANT_CLI=y
BR2_PACKAGE_WPA_SUPPLICANT_DBUS=y
BR2_PACKAGE_KMOD_TOOLS=y
BR2_PACKAGE_PAMTESTER=y
BR2_PACKAGE_SEATD_BUILTIN=y
BR2_PACKAGE_SEATD_DAEMON=y
BR2_PACKAGE_SHADOW=y
BR2_PACKAGE_SHADOW_SUBORDINATE_IDS=y
BR2_PACKAGE_UTIL_LINUX_BINARIES=y
BR2_PACKAGE_UTIL_LINUX_AGETTY=y
BR2_PACKAGE_UTIL_LINUX_FSCK=y
BR2_PACKAGE_UTIL_LINUX_MOUNT=y
BR2_PACKAGE_UTIL_LINUX_PARTX=y
BR2_PACKAGE_UTIL_LINUX_RFKILL=y
BR2_PACKAGE_UTIL_LINUX_SULOGIN=y
BR2_PACKAGE_LESS=y
BR2_PACKAGE_NANO=y
BR2_PACKAGE_GIT=y
BR2_PACKAGE_LIBCURL_CURL=y
BR2_PACKAGE_OPENSSH=y
# BR2_PACKAGE_OPENSSH_SERVER is not set
BR2_PACKAGE_RSYNC=y
BR2_PACKAGE_UNZIP=y
BR2_PACKAGE_ZIP=y
BR2_PACKAGE_FILE=y
BR2_PACKAGE_JQ=y
BR2_PACKAGE_HTOP=y
BR2_TARGET_ROOTFS_TAR_BZIP2=y
BR2_PACKAGE_HOST_DOSFSTOOLS=y
BR2_PACKAGE_HOST_GENIMAGE=y
BR2_PACKAGE_HOST_MTOOLS=y
BR2_PACKAGE_HOST_XORRISO=y
BR2_PACKAGE_GST_PLUGINS_RS=y
BR2_PACKAGE_LABWC=y
BR2_PACKAGE_WEBKITGTK_PREBUILT=y
BR2_PACKAGE_INTER_FONT=y
BR2_PACKAGE_SINGULARITY_SHELL=y
BR2_PACKAGE_SINGULARITY_GREETER=y
BR2_PACKAGE_SINGULARITY_BOOT_SPLASH=y
BR2_PACKAGE_SINIT=y
BR2_PACKAGE_ATOM_INSTALL=y
BR2_PACKAGE_ATOM_PROBE=y
BR2_PACKAGE_ATOM_RECOVERY=y
BR2_PACKAGE_SINTY_RECOVERY_UI=y
BR2_PACKAGE_SINTY_CRYPTO=y
BR2_PACKAGE_SINTY_RECOVERD=y
BR2_PACKAGE_SINTY_LOGIND=y
BR2_PACKAGE_SINTY_DEVD=y
BR2_PACKAGE_SINTY_NMD=y
BR2_PACKAGE_SINTY_SDB=y
BR2_PACKAGE_USH=y
BR2_PACKAGE_SINGULARITY_KEYRING=y
BR2_PACKAGE_SINGULARITY_FILES=y
BR2_PACKAGE_SINGULARITY_EDIT=y
BR2_PACKAGE_SINGULARITY_WRITE=y
BR2_PACKAGE_SINGULARITY_STORE=y
BR2_PACKAGE_SINGULARITY_MONITOR=y
BR2_PACKAGE_SINGULARITY_GIT=y
BR2_PACKAGE_SINGULARITY_MUSIC=y
BR2_PACKAGE_SINGULARITY_PHOTOS=y
BR2_PACKAGE_SINGULARITY_VIDEOS=y
BR2_PACKAGE_SINGULARITY_CALENDAR=y
BR2_PACKAGE_SINGULARITY_CALCULATOR=y
BR2_PACKAGE_SINGULARITY_LEAFS=y
BR2_PACKAGE_SINGULARITY_INSTALLER=y
BR2_PACKAGE_SINGULARITY_DESKTOP_DATA=y
BR2_PACKAGE_SINGULARITY_MESSAGES=y
BR2_PACKAGE_MESA3D_OPENGL_GLX=y
BR2_PACKAGE_LIBFPRINT=y
BR2_PACKAGE_FPRINTD=y
BR2_PACKAGE_SINGULARITY_GESTURES=y
BR2_PACKAGE_SINGULARITY_ACCOUNTS=y
BR2_PACKAGE_SINGULARITY_ATELIER=y
BR2_PACKAGE_SINGULARITY_AUTHENTICATOR=y
BR2_PACKAGE_SINGULARITY_BACKUPS=y
BR2_PACKAGE_SINGULARITY_BROWSER=y
BR2_PACKAGE_SINGULARITY_CAMERA=y
BR2_PACKAGE_SINGULARITY_CHARACTERS=y
BR2_PACKAGE_SINGULARITY_CLOCK=y
BR2_PACKAGE_SINGULARITY_COLORPICKER=y
BR2_PACKAGE_SINGULARITY_CONTACTS=y
BR2_PACKAGE_SINGULARITY_DATABASE=y
BR2_PACKAGE_SINGULARITY_DEMO=y
BR2_PACKAGE_SINGULARITY_DISKS=y
BR2_PACKAGE_SINGULARITY_DRAW=y
BR2_PACKAGE_SINGULARITY_DRIVEWRITER=y
BR2_PACKAGE_SINGULARITY_FEDIVERSE=y
BR2_PACKAGE_SINGULARITY_FONTS=y
BR2_PACKAGE_SINGULARITY_FORMULA=y
BR2_PACKAGE_SINGULARITY_HELP=y
BR2_PACKAGE_SINGULARITY_KEYFRAME=y
BR2_PACKAGE_SINGULARITY_LETTERE=y
BR2_PACKAGE_SINGULARITY_LOGS=y
BR2_PACKAGE_SINGULARITY_MACHINES=y
BR2_PACKAGE_SINGULARITY_MAPS=y
BR2_PACKAGE_SINGULARITY_MEDIA_PLUGINS=y
BR2_PACKAGE_SINGULARITY_MONTAGE=y
BR2_PACKAGE_SINGULARITY_NEWS=y
BR2_PACKAGE_SINGULARITY_NOTES=y
BR2_PACKAGE_SINGULARITY_PASSWORDS=y
BR2_PACKAGE_SINGULARITY_PODCASTS=y
BR2_PACKAGE_SINGULARITY_PRINTERS=y
BR2_PACKAGE_SINGULARITY_PUBLISH=y
BR2_PACKAGE_SINGULARITY_QRCODES=y
BR2_PACKAGE_SINGULARITY_RADIO=y
BR2_PACKAGE_SINGULARITY_READER=y
BR2_PACKAGE_SINGULARITY_SCANNER=y
BR2_PACKAGE_SINGULARITY_SLIDES=y
BR2_PACKAGE_SINGULARITY_SPREADSHEET=y
BR2_PACKAGE_SINGULARITY_TASKS=y
BR2_PACKAGE_SINGULARITY_TOUR=y
BR2_PACKAGE_SINGULARITY_TRANSLATE=y
BR2_PACKAGE_SINGULARITY_USAGE=y
BR2_PACKAGE_SINGULARITY_VECTOR=y
BR2_PACKAGE_SINGULARITY_VOICE=y
BR2_PACKAGE_SINGULARITY_WAVE=y
BR2_PACKAGE_SINGULARITY_WEATHER=y
BR2_PACKAGE_SINGULARITY_CONNECTIONS=y
BR2_PACKAGE_SINGULARITY_NEARBY_APP=y
BR2_PACKAGE_SINGULARITY_THEMES=y
BR2_PACKAGE_SINGULARITY_WALLPAPERS=y
BR2_PACKAGE_SINGULARITY_WIDGETS=y
BR2_PACKAGE_SINGULARITY_PLUGINS=y
BR2_PACKAGE_SINGULARITY_POLKIT_AGENT=y
BR2_PACKAGE_SINGULARITY_SHARING=y
BR2_PACKAGE_XDG_DESKTOP_PORTAL_SINGULARITY=y
BR2_PACKAGE_SINGULARITY_SPLASH=y
BR2_PACKAGE_SINTY_TIMEDATE=y
BR2_PACKAGE_SINTY_HOSTNAME=y
BR2_PACKAGE_SINTY_LOCALE=y
BR2_PACKAGE_TESSERACT_OCR=y
BR2_PACKAGE_SINTY_TESSDATA=y
BR2_PACKAGE_WHISPER_CPP=y
BR2_PACKAGE_LIBHEIF=y
BR2_PACKAGE_LIBHEIF_TOOLS=y
BR2_PACKAGE_GHOSTSCRIPT=y
BR2_PACKAGE_XSETTINGSD=y
BR2_PACKAGE_TRACKER_MINERS=y
BR2_PACKAGE_XDG_DESKTOP_PORTAL=y
BR2_PACKAGE_XDG_USER_DIRS=y
BR2_PACKAGE_FLATPAK=y
BR2_PACKAGE_SINTY_SH=y
BR2_PACKAGE_UUTILS_COREUTILS=y
BR2_PACKAGE_GREP=y
BR2_PACKAGE_SED=y
BR2_PACKAGE_GAWK=y
BR2_PACKAGE_FINDUTILS=y
BR2_PACKAGE_DIFFUTILS=y
BR2_PACKAGE_PATCH=y
BR2_PACKAGE_TAR=y
BR2_PACKAGE_GZIP=y
BR2_PACKAGE_WHICH=y
BR2_PACKAGE_PROCPS_NG=y
BR2_PACKAGE_PSMISC=y
BR2_PACKAGE_IPROUTE2=y
BR2_PACKAGE_IPUTILS=y
BR2_PACKAGE_NANO=y
BR2_PACKAGE_UTIL_LINUX_EJECT=y
BR2_PACKAGE_UTIL_LINUX_FALLOCATE=y
BR2_PACKAGE_UTIL_LINUX_HWCLOCK=y
BR2_PACKAGE_UTIL_LINUX_IPCRM=y
BR2_PACKAGE_UTIL_LINUX_IPCS=y
BR2_PACKAGE_UTIL_LINUX_LOGGER=y
BR2_PACKAGE_UTIL_LINUX_LOSETUP=y
BR2_PACKAGE_UTIL_LINUX_MOUNTPOINT=y
BR2_PACKAGE_UTIL_LINUX_NOLOGIN=y
BR2_PACKAGE_UTIL_LINUX_NSENTER=y
BR2_PACKAGE_UTIL_LINUX_PIVOT_ROOT=y
BR2_PACKAGE_UTIL_LINUX_SCHEDUTILS=y
BR2_PACKAGE_UTIL_LINUX_SETPRIV=y
BR2_PACKAGE_UTIL_LINUX_SWITCH_ROOT=y
BR2_PACKAGE_UTIL_LINUX_UNSHARE=y
BR2_PACKAGE_UTIL_LINUX_WIPEFS=y
BR2_SYSTEM_BIN_SH_NONE=y
BR2_ROOTFS_POST_FAKEROOT_SCRIPT="$(BR2_EXTERNAL_SINGULARITY_PATH)/scripts/post-fakeroot.sh"
BR2_PACKAGE_SINTY_POWERD=y
BR2_PACKAGE_NCURSES_TARGET_PROGS=y
BR2_PACKAGE_SINTY_DISKD=y
BR2_PACKAGE_SINTY_SXI=y
BR2_PACKAGE_DOSFSTOOLS_FATLABEL=y
BR2_PACKAGE_DOSFSTOOLS_FSCK_FAT=y
BR2_PACKAGE_DOSFSTOOLS_MKFS_FAT=y
BR2_PACKAGE_E2FSPROGS_RESIZE2FS=y
BR2_PACKAGE_EXFATPROGS=y
```

## package/alsa-ucm-conf/Config.in
```kconfig
config BR2_PACKAGE_ALSA_UCM_CONF
	bool "alsa-ucm-conf"
	depends on BR2_PACKAGE_ALSA_LIB
	help
	  ALSA Use Case Manager configuration. Sound cards driven by
	  Intel SOF and other modern DSPs only expose speakers,
	  headphones and microphones through these profiles.

	  https://github.com/alsa-project/alsa-ucm-conf
```

## package/appstream/Config.in
```kconfig
config BR2_PACKAGE_APPSTREAM
	bool "appstream"
	select BR2_PACKAGE_LIBGLIB2
	select BR2_PACKAGE_LIBXML2
	select BR2_PACKAGE_LIBYAML
	select BR2_PACKAGE_LIBXMLB
	select BR2_PACKAGE_LIBCURL
	help
	  AppStream is a metadata specification and library for
	  software components (provides appstream / libappstream).
	  Required by flatpak.

	  https://www.freedesktop.org/wiki/Distributions/AppStream/
```

## package/atom-firstboot/Config.in
```kconfig
config BR2_PACKAGE_ATOM_FIRSTBOOT
	bool "atom-firstboot"
	depends on BR2_PACKAGE_HOST_GO_TARGET_ARCH_SUPPORTS
	help
	  First-boot provisioning agent (OOBE): creates the user,
	  seals the PIN and sets up the initial system state.
```

## package/atom-install/Config.in
```kconfig
config BR2_PACKAGE_ATOM_INSTALL
	bool "atom-install"
	depends on BR2_PACKAGE_HOST_GO_TARGET_ARCH_SUPPORTS
	depends on BR2_PACKAGE_HOST_GO_TARGET_CGO_LINKING_SUPPORTS
	help
	  atom-install: the disk installer the graphical installer spawns.
	  Partitions the target disk (ESP + atom-system + atom-var), writes
	  the root image and its verity hash tree as the active slot files,
	  and seeds the first-boot /var. Installs /usr/bin/atom-install.
```

## package/atom-probe/Config.in
```kconfig
config BR2_PACKAGE_ATOM_PROBE
	bool "atom-probe"
	depends on BR2_PACKAGE_HOST_GO_TARGET_ARCH_SUPPORTS
	depends on BR2_PACKAGE_HOST_GO_TARGET_CGO_LINKING_SUPPORTS
	help
	  atom-probe: the on-device diagnostic probe from the atom source
	  tree (cmd/atom-probe), the same repo as sinit. Installs
	  /usr/bin/atom-probe. Fenced at runtime by /etc/atom/probe.enabled,
	  which release images strip, so a release ships the binary inert.

	  https://github.com/singularityos-lab/atom
```

## package/atom-recovery/Config.in
```kconfig
config BR2_PACKAGE_ATOM_RECOVERY
	bool "atom-recovery"
	depends on BR2_PACKAGE_HOST_GO_TARGET_ARCH_SUPPORTS
	depends on BR2_PACKAGE_HOST_GO_TARGET_CGO_LINKING_SUPPORTS
	help
	  The Sinty recovery agent: drives the recovery Core (wifi
	  bring-up, reinstall, repair, rollback) and exposes a local
	  HTTP API over /run/atom-recovery.sock so the graphical
	  recovery UI drives the same Core the text UI uses.

	  https://github.com/singularityos-lab/sinty-recovery
```

## package/atomloops/Config.in
```kconfig
config BR2_PACKAGE_ATOMLOOPS
	bool "atomloops"
	depends on BR2_PACKAGE_HOST_GO_TARGET_ARCH_SUPPORTS
	help
	  The Atom Loops OTA daemons (atomd, updated) plus fw-verify, the
	  firmware-bundle anchor verifier used by the initramfs and the
	  post-boot firmware device-probe. Installs the release root public
	  key at /etc/atom-fw-root.pub.

	  https://github.com/mirkobrombin/atomloops
```

## package/cpak-prebuilt/Config.in
```kconfig
config BR2_PACKAGE_CPAK_PREBUILT
	bool "cpak (prebuilt)"
	depends on BR2_x86_64
	help
	  cpak container package manager, built in managed self-update
	  mode, with its storage daemon, slirp4netns and the system
	  authority D-Bus service.

	  https://github.com/Containerpak/cpak
```

## package/cpak/Config.in
```kconfig
config BR2_PACKAGE_CPAK
	bool "cpak"
	depends on BR2_aarch64
	depends on BR2_PACKAGE_HOST_GO_TARGET_ARCH_SUPPORTS
	depends on BR2_PACKAGE_LIBGTK4
	help
	  cpak container package manager built from source, in managed
	  self-update mode, with its storage daemon, slirp4netns and the
	  system authority D-Bus service. Same layout as the x86_64
	  prebuilt.

	  https://github.com/containerpak/cpak
```

## package/espeak-ng/Config.in
```kconfig
config BR2_PACKAGE_ESPEAK_NG
	bool "espeak-ng"
	depends on BR2_INSTALL_LIBSTDCPP
	help
	  Compact speech synthesizer with voices for more than a
	  hundred languages. The language data is compiled on the
	  build host.

	  https://github.com/espeak-ng/espeak-ng
```

## package/flatpak/Config.in
```kconfig
config BR2_PACKAGE_FLATPAK
	bool "flatpak"
	select BR2_PACKAGE_APPSTREAM
	select BR2_PACKAGE_BUBBLEWRAP
	select BR2_PACKAGE_XDG_DBUS_PROXY
	select BR2_PACKAGE_LIBGLIB2
	select BR2_PACKAGE_LIBOSTREE
	select BR2_PACKAGE_LIBGPGME
	select BR2_PACKAGE_JSON_GLIB
	select BR2_PACKAGE_LIBCURL
	select BR2_PACKAGE_LIBARCHIVE
	select BR2_PACKAGE_LIBSECCOMP
	select BR2_PACKAGE_LIBFUSE3
	select BR2_PACKAGE_LIBXML2
	select BR2_PACKAGE_LIBCAP
	select BR2_PACKAGE_GDK_PIXBUF
	help
	  Flatpak is a system for building, distributing, and running
	  sandboxed desktop applications on Linux.

	  https://flatpak.org
```

## package/fotone-prebuilt/Config.in
```kconfig
config BR2_PACKAGE_FOTONE_PREBUILT
	bool "fotone (prebuilt)"
	depends on BR2_x86_64
	depends on BR2_PACKAGE_WEBKITGTK_PREBUILT
	help
	  Fotone web engine: WPE WebKit with the Sinty patches and the
	  WebKitGTK compatible libraries that apps load in its place.

	  https://github.com/singularityos-lab/fotone
```
