## Config.in
```kconfig
menu "Singularity"
	source "$BR2_EXTERNAL_SINGULARITY_PATH/package/mts/Config.in"
	source "$BR2_EXTERNAL_SINGULARITY_PATH/package/gst-plugins-rs/Config.in"
	source "$BR2_EXTERNAL_SINGULARITY_PATH/package/gtk4-layer-shell/Config.in"
	source "$BR2_EXTERNAL_SINGULARITY_PATH/package/libpeas2/Config.in"
	source "$BR2_EXTERNAL_SINGULARITY_PATH/package/vte-gtk4/Config.in"
	source "$BR2_EXTERNAL_SINGULARITY_PATH/package/singularity-loginui/Config.in"
	source "$BR2_EXTERNAL_SINGULARITY_PATH/package/libsingularity/Config.in"
	source "$BR2_EXTERNAL_SINGULARITY_PATH/package/libliftoff/Config.in"
	source "$BR2_EXTERNAL_SINGULARITY_PATH/package/wlroots020/Config.in"
	source "$BR2_EXTERNAL_SINGULARITY_PATH/package/labwc/Config.in"
	source "$BR2_EXTERNAL_SINGULARITY_PATH/package/tracker/Config.in"
	source "$BR2_EXTERNAL_SINGULARITY_PATH/package/librest/Config.in"
	source "$BR2_EXTERNAL_SINGULARITY_PATH/package/webkitgtk-prebuilt/Config.in"
	source "$BR2_EXTERNAL_SINGULARITY_PATH/package/inter-font/Config.in"
	source "$BR2_EXTERNAL_SINGULARITY_PATH/package/gnome-online-accounts/Config.in"
	source "$BR2_EXTERNAL_SINGULARITY_PATH/package/libdbusmenu/Config.in"
	source "$BR2_EXTERNAL_SINGULARITY_PATH/package/greetd/Config.in"
	source "$BR2_EXTERNAL_SINGULARITY_PATH/package/singularity-shell/Config.in"
	source "$BR2_EXTERNAL_SINGULARITY_PATH/package/singularity-greeter/Config.in"
	source "$BR2_EXTERNAL_SINGULARITY_PATH/package/singularity-boot-splash/Config.in"
	source "$BR2_EXTERNAL_SINGULARITY_PATH/package/libsystemd-shim/Config.in"
	source "$BR2_EXTERNAL_SINGULARITY_PATH/package/sinit/Config.in"
	source "$BR2_EXTERNAL_SINGULARITY_PATH/package/atom-install/Config.in"
	source "$BR2_EXTERNAL_SINGULARITY_PATH/package/atom-probe/Config.in"
	source "$BR2_EXTERNAL_SINGULARITY_PATH/package/sinty-crypto/Config.in"
	source "$BR2_EXTERNAL_SINGULARITY_PATH/package/sinty-recoverd/Config.in"
	source "$BR2_EXTERNAL_SINGULARITY_PATH/package/atom-recovery/Config.in"
	source "$BR2_EXTERNAL_SINGULARITY_PATH/package/atomloops/Config.in"
		source "$BR2_EXTERNAL_SINGULARITY_PATH/package/atom-firstboot/Config.in"
	source "$BR2_EXTERNAL_SINGULARITY_PATH/package/sinty-nmd/Config.in"
	source "$BR2_EXTERNAL_SINGULARITY_PATH/package/sinty-sdb/Config.in"
	source "$BR2_EXTERNAL_SINGULARITY_PATH/package/sinty-timedate/Config.in"
	source "$BR2_EXTERNAL_SINGULARITY_PATH/package/sinty-hostname/Config.in"
	source "$BR2_EXTERNAL_SINGULARITY_PATH/package/sinty-locale/Config.in"
	source "$BR2_EXTERNAL_SINGULARITY_PATH/package/sinty-recovery-ui/Config.in"
	source "$BR2_EXTERNAL_SINGULARITY_PATH/package/sinty-logind/Config.in"
	source "$BR2_EXTERNAL_SINGULARITY_PATH/package/pam-rundir/Config.in"
	source "$BR2_EXTERNAL_SINGULARITY_PATH/package/power-profiles-daemon/Config.in"
	source "$BR2_EXTERNAL_SINGULARITY_PATH/package/ush/Config.in"
	source "$BR2_EXTERNAL_SINGULARITY_PATH/package/singularity-keyring/Config.in"
	source "$BR2_EXTERNAL_SINGULARITY_PATH/package/singularity-files/Config.in"
	source "$BR2_EXTERNAL_SINGULARITY_PATH/package/singularity-edit/Config.in"
	source "$BR2_EXTERNAL_SINGULARITY_PATH/package/mythes-data/Config.in"
	source "$BR2_EXTERNAL_SINGULARITY_PATH/package/singularity-write/Config.in"
	source "$BR2_EXTERNAL_SINGULARITY_PATH/package/singularity-nearby/Config.in"
	source "$BR2_EXTERNAL_SINGULARITY_PATH/package/singularity-nearby-app/Config.in"
	source "$BR2_EXTERNAL_SINGULARITY_PATH/package/singularity-sharing/Config.in"
	source "$BR2_EXTERNAL_SINGULARITY_PATH/package/singularity-messages/Config.in"
	source "$BR2_EXTERNAL_SINGULARITY_PATH/package/libgusb/Config.in"
	source "$BR2_EXTERNAL_SINGULARITY_PATH/package/libfprint/Config.in"
	source "$BR2_EXTERNAL_SINGULARITY_PATH/package/fprintd/Config.in"
	source "$BR2_EXTERNAL_SINGULARITY_PATH/package/singularity-gestures/Config.in"
	source "$BR2_EXTERNAL_SINGULARITY_PATH/package/singularity-accounts/Config.in"
	source "$BR2_EXTERNAL_SINGULARITY_PATH/package/singularity-atelier/Config.in"
	source "$BR2_EXTERNAL_SINGULARITY_PATH/package/singularity-authenticator/Config.in"
	source "$BR2_EXTERNAL_SINGULARITY_PATH/package/singularity-backups/Config.in"
	source "$BR2_EXTERNAL_SINGULARITY_PATH/package/singularity-browser/Config.in"
	source "$BR2_EXTERNAL_SINGULARITY_PATH/package/singularity-camera/Config.in"
	source "$BR2_EXTERNAL_SINGULARITY_PATH/package/singularity-characters/Config.in"
	source "$BR2_EXTERNAL_SINGULARITY_PATH/package/singularity-clock/Config.in"
	source "$BR2_EXTERNAL_SINGULARITY_PATH/package/singularity-colorpicker/Config.in"
	source "$BR2_EXTERNAL_SINGULARITY_PATH/package/singularity-contacts/Config.in"
	source "$BR2_EXTERNAL_SINGULARITY_PATH/package/singularity-database/Config.in"
	source "$BR2_EXTERNAL_SINGULARITY_PATH/package/singularity-demo/Config.in"
	source "$BR2_EXTERNAL_SINGULARITY_PATH/package/singularity-disks/Config.in"
	source "$BR2_EXTERNAL_SINGULARITY_PATH/package/singularity-draw/Config.in"
	source "$BR2_EXTERNAL_SINGULARITY_PATH/package/singularity-drivewriter/Config.in"
	source "$BR2_EXTERNAL_SINGULARITY_PATH/package/singularity-fediverse/Config.in"
	source "$BR2_EXTERNAL_SINGULARITY_PATH/package/singularity-fonts/Config.in"
	source "$BR2_EXTERNAL_SINGULARITY_PATH/package/singularity-formula/Config.in"
	source "$BR2_EXTERNAL_SINGULARITY_PATH/package/singularity-help/Config.in"
	source "$BR2_EXTERNAL_SINGULARITY_PATH/package/singularity-keyframe/Config.in"
	source "$BR2_EXTERNAL_SINGULARITY_PATH/package/singularity-lettere/Config.in"
	source "$BR2_EXTERNAL_SINGULARITY_PATH/package/singularity-logs/Config.in"
	source "$BR2_EXTERNAL_SINGULARITY_PATH/package/singularity-machines/Config.in"
	source "$BR2_EXTERNAL_SINGULARITY_PATH/package/singularity-maps/Config.in"
	source "$BR2_EXTERNAL_SINGULARITY_PATH/package/singularity-media-plugins/Config.in"
	source "$BR2_EXTERNAL_SINGULARITY_PATH/package/singularity-montage/Config.in"
	source "$BR2_EXTERNAL_SINGULARITY_PATH/package/singularity-news/Config.in"
	source "$BR2_EXTERNAL_SINGULARITY_PATH/package/singularity-notes/Config.in"
	source "$BR2_EXTERNAL_SINGULARITY_PATH/package/singularity-passwords/Config.in"
	source "$BR2_EXTERNAL_SINGULARITY_PATH/package/singularity-podcasts/Config.in"
	source "$BR2_EXTERNAL_SINGULARITY_PATH/package/singularity-printers/Config.in"
	source "$BR2_EXTERNAL_SINGULARITY_PATH/package/singularity-publish/Config.in"
	source "$BR2_EXTERNAL_SINGULARITY_PATH/package/singularity-qrcodes/Config.in"
	source "$BR2_EXTERNAL_SINGULARITY_PATH/package/singularity-radio/Config.in"
	source "$BR2_EXTERNAL_SINGULARITY_PATH/package/singularity-reader/Config.in"
	source "$BR2_EXTERNAL_SINGULARITY_PATH/package/singularity-scanner/Config.in"
	source "$BR2_EXTERNAL_SINGULARITY_PATH/package/singularity-slides/Config.in"
	source "$BR2_EXTERNAL_SINGULARITY_PATH/package/singularity-spreadsheet/Config.in"
	source "$BR2_EXTERNAL_SINGULARITY_PATH/package/singularity-tasks/Config.in"
	source "$BR2_EXTERNAL_SINGULARITY_PATH/package/singularity-tour/Config.in"
	source "$BR2_EXTERNAL_SINGULARITY_PATH/package/singularity-translate/Config.in"
	source "$BR2_EXTERNAL_SINGULARITY_PATH/package/singularity-usage/Config.in"
	source "$BR2_EXTERNAL_SINGULARITY_PATH/package/singularity-vector/Config.in"
	source "$BR2_EXTERNAL_SINGULARITY_PATH/package/singularity-voice/Config.in"
	source "$BR2_EXTERNAL_SINGULARITY_PATH/package/singularity-wave/Config.in"
	source "$BR2_EXTERNAL_SINGULARITY_PATH/package/singularity-weather/Config.in"
	source "$BR2_EXTERNAL_SINGULARITY_PATH/package/libcbor/Config.in"
	source "$BR2_EXTERNAL_SINGULARITY_PATH/package/libfido2/Config.in"
	source "$BR2_EXTERNAL_SINGULARITY_PATH/package/singularity-connections/Config.in"
	source "$BR2_EXTERNAL_SINGULARITY_PATH/package/singularity-store/Config.in"
	source "$BR2_EXTERNAL_SINGULARITY_PATH/package/singularity-monitor/Config.in"
	source "$BR2_EXTERNAL_SINGULARITY_PATH/package/singularity-git/Config.in"
	source "$BR2_EXTERNAL_SINGULARITY_PATH/package/singularity-music/Config.in"
	source "$BR2_EXTERNAL_SINGULARITY_PATH/package/singularity-photos/Config.in"
	source "$BR2_EXTERNAL_SINGULARITY_PATH/package/singularity-videos/Config.in"
	source "$BR2_EXTERNAL_SINGULARITY_PATH/package/singularity-calendar/Config.in"
	source "$BR2_EXTERNAL_SINGULARITY_PATH/package/singularity-calculator/Config.in"
	source "$BR2_EXTERNAL_SINGULARITY_PATH/package/singularity-leafs/Config.in"
	source "$BR2_EXTERNAL_SINGULARITY_PATH/package/singularity-installer/Config.in"
	source "$BR2_EXTERNAL_SINGULARITY_PATH/package/singularity-session/Config.in"
	source "$BR2_EXTERNAL_SINGULARITY_PATH/package/singularity-desktop-data/Config.in"
	source "$BR2_EXTERNAL_SINGULARITY_PATH/package/singularity-themes/Config.in"
	source "$BR2_EXTERNAL_SINGULARITY_PATH/package/singularity-wallpapers/Config.in"
	source "$BR2_EXTERNAL_SINGULARITY_PATH/package/singularity-widgets/Config.in"
	source "$BR2_EXTERNAL_SINGULARITY_PATH/package/singularity-plugins/Config.in"
	source "$BR2_EXTERNAL_SINGULARITY_PATH/package/singularity-polkit-agent/Config.in"
	source "$BR2_EXTERNAL_SINGULARITY_PATH/package/xdg-desktop-portal-singularity/Config.in"
	source "$BR2_EXTERNAL_SINGULARITY_PATH/package/singularity-splash/Config.in"
	source "$BR2_EXTERNAL_SINGULARITY_PATH/package/xsettingsd/Config.in"
	source "$BR2_EXTERNAL_SINGULARITY_PATH/package/tracker-miners/Config.in"
	source "$BR2_EXTERNAL_SINGULARITY_PATH/package/xdg-desktop-portal/Config.in"
	source "$BR2_EXTERNAL_SINGULARITY_PATH/package/accountsservice/Config.in"
	source "$BR2_EXTERNAL_SINGULARITY_PATH/package/xdg-user-dirs/Config.in"
	source "$BR2_EXTERNAL_SINGULARITY_PATH/package/appstream/Config.in"
	source "$BR2_EXTERNAL_SINGULARITY_PATH/package/flatpak/Config.in"
endmenu
```
