## package/fotone/Config.in
```kconfig
config BR2_PACKAGE_FOTONE
	bool "fotone"
	depends on BR2_aarch64
	depends on BR2_PACKAGE_WEBKITGTK
	depends on BR2_PACKAGE_HAS_LIBGBM
	depends on BR2_PACKAGE_LIBGTK4
	select BR2_PACKAGE_AT_SPI2_CORE
	select BR2_PACKAGE_ENCHANT
	select BR2_PACKAGE_EXPAT
	select BR2_PACKAGE_FONTCONFIG
	select BR2_PACKAGE_FREETYPE
	select BR2_PACKAGE_GNUTLS
	select BR2_PACKAGE_GSTREAMER1
	select BR2_PACKAGE_GST1_PLUGINS_BASE
	select BR2_PACKAGE_GST1_PLUGINS_BASE_LIB_OPENGL if BR2_PACKAGE_HAS_LIBEGL
	select BR2_PACKAGE_GST1_PLUGINS_BAD
	select BR2_PACKAGE_HARFBUZZ
	select BR2_PACKAGE_ICU
	select BR2_PACKAGE_JPEG
	select BR2_PACKAGE_LCMS2
	select BR2_PACKAGE_LIBAVIF
	select BR2_PACKAGE_LIBDRM
	select BR2_PACKAGE_LIBEPOXY
	select BR2_PACKAGE_LIBGCRYPT
	select BR2_PACKAGE_LIBINPUT
	select BR2_PACKAGE_LIBJXL
	select BR2_PACKAGE_LIBPNG
	select BR2_PACKAGE_LIBSECRET
	select BR2_PACKAGE_LIBSOUP3
	select BR2_PACKAGE_LIBTASN1
	select BR2_PACKAGE_LIBXKBCOMMON
	select BR2_PACKAGE_LIBXML2
	select BR2_PACKAGE_LIBXSLT
	select BR2_PACKAGE_SQLITE
	select BR2_PACKAGE_WAYLAND
	select BR2_PACKAGE_WAYLAND_PROTOCOLS
	select BR2_PACKAGE_WEBP
	select BR2_PACKAGE_WEBP_DEMUX
	select BR2_PACKAGE_WEBP_MUX
	select BR2_PACKAGE_WOFF2
	help
	  Fotone web engine built from source: WPE WebKit with the Sinty
	  patches and the WebKitGTK compatible libraries that apps load
	  in its place.

	  https://github.com/singularityos-lab/fotone
```

## package/fprintd/Config.in
```kconfig
config BR2_PACKAGE_FPRINTD
	bool "fprintd"
	select BR2_PACKAGE_LIBFPRINT
	select BR2_PACKAGE_POLKIT
	select BR2_PACKAGE_DBUS
	help
	  D-Bus daemon that exposes fingerprint readers, used by the
	  Singularity lock screen for fingerprint unlock.

	  https://gitlab.freedesktop.org/libfprint/fprintd
```

## package/gst-plugins-rs/Config.in
```kconfig
config BR2_PACKAGE_GST_PLUGINS_RS
	bool "gst-plugins-rs (gtk4 paintable sink)"
	depends on BR2_PACKAGE_HOST_RUSTC_TARGET_ARCH_SUPPORTS
	depends on BR2_PACKAGE_GSTREAMER1
	depends on BR2_PACKAGE_LIBGTK4
	select BR2_PACKAGE_HOST_RUSTC
	select BR2_PACKAGE_GST1_PLUGINS_BASE
	help
	  The gtk4paintablesink GStreamer plugin from gst-plugins-rs, required
	  by GNOME Videos and other GTK4 media apps to render video. Only the
	  gtk4 plugin is built (not the whole workspace).

	  https://gitlab.freedesktop.org/gstreamer/gst-plugins-rs
```

## package/intel-wireless-legacy-firmware/Config.in
```kconfig
config BR2_PACKAGE_INTEL_WIRELESS_LEGACY_FIRMWARE
	bool "intel-wireless-legacy-firmware"
	help
	  Firmware for Intel Wireless 3160, 3165, 3168, 7260 and 7265
	  Wi-Fi cards and their Bluetooth, which the linux-firmware
	  package no longer installs since the files moved under intel/.

	  https://gitlab.com/kernel-firmware/linux-firmware
```

## package/inter-font/Config.in
```kconfig
config BR2_PACKAGE_INTER_FONT
	bool "inter-font"
	help
	  Inter, a typeface carefully crafted and designed for computer
	  screens and user interfaces.

	  https://rsms.me/inter/
```

## package/libcbor/Config.in
```kconfig
config BR2_PACKAGE_LIBCBOR
	bool "libcbor"
	help
	  CBOR (RFC 8949) parsing and encoding library, used by
	  libfido2 for the CTAP2 protocol.

	  https://github.com/PJK/libcbor
```

## package/libfido2/Config.in
```kconfig
config BR2_PACKAGE_LIBFIDO2
	bool "libfido2"
	depends on BR2_PACKAGE_HAS_UDEV
	select BR2_PACKAGE_LIBCBOR
	select BR2_PACKAGE_OPENSSL
	select BR2_PACKAGE_ZLIB
	help
	  FIDO2 / U2F security key library, used by the Singularity
	  Browser for WebAuthn sign-in with hardware keys.

	  https://developers.yubico.com/libfido2/
```

## package/libfprint/Config.in
```kconfig
config BR2_PACKAGE_LIBFPRINT
	bool "libfprint"
	depends on BR2_PACKAGE_HAS_UDEV
	select BR2_PACKAGE_LIBGUSB
	select BR2_PACKAGE_LIBGUDEV
	select BR2_PACKAGE_PIXMAN
	select BR2_PACKAGE_OPENSSL
	help
	  Fingerprint reader library, used by the Singularity lock
	  screen for fingerprint unlock.

	  https://gitlab.freedesktop.org/3v1n0/libfprint
```

## package/libgusb/Config.in
```kconfig
config BR2_PACKAGE_LIBGUSB
	bool "libgusb"
	select BR2_PACKAGE_LIBUSB
	select BR2_PACKAGE_JSON_GLIB
	select BR2_PACKAGE_HWDATA
	select BR2_PACKAGE_HWDATA_USB_IDS
	help
	  GObject wrapper for libusb, used by libfprint to reach
	  fingerprint readers.

	  https://github.com/hughsie/libgusb
```

## package/libsystemd-shim/Config.in
```kconfig
config BR2_PACKAGE_LIBSYSTEMD_SHIM
	bool "libsystemd-shim"
	help
	  A dependency-light libsystemd.so.0 replacement for Singularity OS
	  running under sinit (no systemd). Provides the sd_* ABI backed by
	  sinit (sd-daemon), our syslogd (sd-journal), seatd + a /run session
	  registry (sd-login) and the real dbus-daemon via libdbus-1 (sd-bus),
	  plus build-time headers and pkg-config so packages that link
	  libsystemd build and run with no systemd present.
```

## package/linux-l4t/Config.in
```kconfig
config BR2_PACKAGE_LINUX_L4T
	bool "linux-l4t"
	depends on BR2_aarch64
	depends on BR2_LINUX_KERNEL
	help
	  The NVIDIA Jetson Linux r36 kernel with its out-of-tree
	  drivers (nvgpu, display, ethernet, camera), built with the
	  same feature set as the mainline kernel. Its UKI boots on
	  Jetson Orin boards, every other board keeps mainline.

	  https://developer.nvidia.com/embedded/jetson-linux

comment "linux-l4t needs a Linux kernel to be built"
	depends on BR2_aarch64
	depends on !BR2_LINUX_KERNEL
```
